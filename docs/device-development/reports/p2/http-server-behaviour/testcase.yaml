## modules/flash-sram-proxy/dts/bindings/mtd/cedar,flash-sram-proxy.yaml
```yaml
# Copyright (c) 2026 Cedar
# SPDX-License-Identifier: Apache-2.0

description: |
  A flash device in front of another one (the backend) that makes every access
  to the backend from one thread whose stack, and through one buffer, both in
  SRAM. For SPI flash behind a DMA-driven SPI controller when callers' stacks
  and buffers live in memory the DMA must not touch (external PSRAM behind
  DCACHE1 on STM32U5). Put the backend's fixed-partitions under this node.

compatible: "cedar,flash-sram-proxy"

include: base.yaml

properties:
  backend:
    type: phandle
    required: true
    description: The flash device every operation is forwarded to.
```

## modules/job-manager/lib/Kconfig
```kconfig
# Entry point sourced into the global Kconfig tree (via zephyr/module.yml).

menuconfig JOB_MANAGER
	bool "Job manager for long-running web API operations"
	help
	  Identity, lifecycle and idempotency for operations that cannot finish
	  inside an HTTP handler: network apply, Wi-Fi scan, firmware upload and
	  install, Matter commissioning window, password change. Fixed pools, no
	  dynamic allocation. See include/job_manager/job_manager.h.

if JOB_MANAGER

config JOB_MANAGER_MAX_JOBS
	int "Full job records"
	default 16
	range 4 64
	help
	  Records holding a complete job, including phase and progress. Active
	  jobs are never evicted from this pool; when it is full of terminal
	  jobs the oldest is retired into the compact tier, and when it is full
	  of active jobs job_create() reports exhaustion so the caller can
	  answer 429 instead of losing work.

config JOB_MANAGER_DEDUPE_SLOTS
	int "Compact retention records"
	default 256
	range 16 1024
	help
	  Much smaller records that outlive full ones, keeping a job's id, its
	  idempotency key and its outcome available after the full record is
	  evicted. This is what stops a late retry from executing an action a
	  second time. Sized generously because each entry is cheap.

config JOB_MANAGER_RETENTION_SECONDS
	int "How long a compact record answers a retry, in seconds"
	default 900
	range 60 7200
	help
	  The API contract requires at least 15 minutes (900 s). Retention is
	  measured on the monotonic clock, so it is unaffected by wall-clock
	  changes and does not survive a reboot — which is correct, since job
	  ids are only unique within a boot.

endif # JOB_MANAGER
```

## modules/log-store/lib/Kconfig
```kconfig
# Entry point sourced into the global Kconfig tree (via zephyr/module.yml).

menuconfig LOG_STORE
	bool "Bounded log rings for the web interface"
	help
	  One byte ring per log source (STM32, ESP32) with a global sequence,
	  cursors bound to filters and boot, gaps when a reader falls behind,
	  and loss counters. See include/log_store/log_store.h.

if LOG_STORE

config LOG_STORE_STM32_KIB
	int "STM32 ring size, KiB (power of two)"
	default 256
	range 4 4096
	help
	  Records of the Zephyr log. The plan's starting budget is 256 KiB per
	  source (section 9); must be a power of two.

config LOG_STORE_ESP32_KIB
	int "ESP32 ring size, KiB (power of two)"
	default 256
	range 4 4096
	help
	  Lines received from the C6's UART. Must be a power of two.

config LOG_STORE_SCAN_BUDGET
	int "Records a reader looks at per request"
	default 2048
	range 16 65536
	help
	  The bound callers pass to log_store_read() and
	  log_store_reader_tail(): how many records, matching or not, one HTTP
	  request may walk before it answers with a cursor that continues the
	  scan. Bounds the time a request spends on the server's one thread.

endif # LOG_STORE
```

## modules/matter-service/lib/Kconfig
```kconfig
# Entry point sourced into the global Kconfig tree (via zephyr/module.yml).

menuconfig MATTER_SERVICE
	bool "Matter state, commissioning window, codes and fabrics for the web interface"
	help
	  A snapshot of the Matter stack that any thread may read without waiting
	  for it, and requests to open and close the commissioning window that
	  finish on the Matter thread. No Matter types in here: the firmware's
	  adapter reaches the SDK. See include/matter_service/matter_service.h.

if MATTER_SERVICE

config MATTER_SERVICE_MAX_FABRICS
	int "Fabrics in the snapshot"
	default 5
	range 1 254
	help
	  Must not be smaller than the SDK's fabric table (CHIP_CONFIG_MAX_FABRICS,
	  5 on Zephyr); the firmware's adapter checks that at build time, so a
	  fabric can never be left out of the list without anyone noticing.

config MATTER_SERVICE_REQUEST_SLOTS
	int "Open and close requests waiting for the Matter thread"
	default 4
	range 1 16
	help
	  One per request accepted and not yet run. The Matter thread runs them
	  within milliseconds, so this only bounds a burst; a request that finds
	  every slot taken is answered "busy, retry".

endif # MATTER_SERVICE
```

## modules/network-manager/lib/Kconfig
```kconfig
# Entry point sourced into the global Kconfig tree (via zephyr/module.yml).

menuconfig NETWORK_MANAGER
	bool "Transactional network configuration"
	select DEVICE_CONFIG_STORE
	select JOB_MANAGER
	select API_VALIDATION
	help
	  The transaction that changes this device's network without being able
	  to lose it: validate, journal, apply, confirm — with a deadline that
	  rolls the change back when nobody can confirm it, because the only way
	  to manage this device is over the network it just changed. No threads
	  and no I/O of its own; interfaces are reached through an injected
	  adapter. See include/network_manager/network_manager.h.

if NETWORK_MANAGER

config NETWORK_MANAGER_CANDIDATE_TTL_SECONDS
	int "How long a staged candidate survives without being applied"
	default 300
	range 30 3600
	help
	  The API contract specifies 300 seconds. A candidate holds the one
	  transaction slot, so leaving one behind would block the next change;
	  it also holds a Wi-Fi password in RAM, which is a second reason not to
	  keep it indefinitely.

config NETWORK_MANAGER_CONFIRM_TIMEOUT_SECONDS
	int "Default seconds a client has to confirm an applied change"
	default 120
	range 30 900
	help
	  Used when a request does not name its own timeout. The contract's
	  starting value is 120 seconds, chosen to cover a browser that has to
	  find the device at a new address and, if the address changed, log in
	  again.

config NETWORK_MANAGER_CONFIRM_TIMEOUT_MIN_SECONDS
	int "Smallest confirmation timeout a request may ask for"
	default 30
	range 10 300
	help
	  Below this a client that merely has to reconnect would run out of time
	  through no fault of the configuration, and the device would roll back
	  a change that was working.

config NETWORK_MANAGER_CONFIRM_TIMEOUT_MAX_SECONDS
	int "Largest confirmation timeout a request may ask for"
	default 900
	range 60 3600
	help
	  Above this an unreachable device stays unreachable for longer than
	  anyone will wait before power-cycling it, which defeats the point of
	  the deadline.

config NETWORK_MANAGER_SCAN_MAX_RESULTS
	int "Access points kept from one scan"
	default 64
	range 8 128
	help
	  The contract caps a scan response at 64 records and requires
	  `truncated=true` when more were seen. Each record is small, but the
	  array is statically allocated, so this is real RAM.

config NETWORK_MANAGER_LOG_LEVEL
	int "Log level"
	default 3
	range 0 4
	help
	  Standard Zephyr levels: 0 none, 1 error, 2 warning, 3 info, 4 debug.
	  Transitions are logged at info because "this device rolled back your
	  network change" is the first thing anyone reading a boot log needs to
	  see. Nothing here ever logs a password or an SSID.

endif # NETWORK_MANAGER
```

## modules/psa-driver-stm32/Kconfig
```kconfig
# Entry point sourced into the global Kconfig tree (via zephyr/module.yml).

config STM32_PKA
	bool "STM32 PKA: P-256 primitives on the public key accelerator"
	default y
	depends on DT_HAS_ST_STM32_PKA_ENABLED
	depends on CLOCK_CONTROL
	select USE_STM32_HAL_PKA
	help
	  Brings up the PKA block (with the RNG clock it needs on STM32U5) and
	  offers P-256 scalar multiplication, point check, ECDSA sign and verify
	  on big-endian 32-byte buffers. Calls are serialised by a mutex and
	  block the caller (polling); do not call from an ISR.

if STM32_PKA

config STM32_PKA_TIMEOUT_MS
	int "Timeout of one PKA operation, ms"
	default 5000

config STM32_PKA_SHELL
	bool "Shell command 'pka': known-answer tests and benchmark"
	default y
	depends on SHELL

config PSA_CRYPTO_DRIVER_STM32_PKA
	bool "PSA Crypto driver: P-256 ECDSA, ECDH, key generation on the PKA"
	depends on TF_PSA_CRYPTO_BUILTIN
	help
	  Transparent driver entry points (sign_hash, verify_hash, generate_key,
	  export_public_key, key_agreement) hooked into a copy of the TF-PSA-Crypto
	  dispatch (modules/psa-driver-stm32/dispatch). The application's root
	  Kconfig points TF_PSA_CRYPTO_DISPATCH_DIR at that copy. Other curves and
	  algorithms fall through to p256-m / builtin.

config PSA_CRYPTO_DRIVER_STM32_PKA_DEFAULT_ON
	bool "Use the PKA from boot (shell 'pka psa on|off' switches at runtime)"
	default y
	depends on PSA_CRYPTO_DRIVER_STM32_PKA
	help
	  With this off the driver is still linked (same image layout) but every
	  entry point returns PSA_ERROR_NOT_SUPPORTED until 'pka psa on'.

config STM32_PKA_ECP_P256
	bool "Builtin ECP: P-256 mbedtls_ecp_mul/muladd on the PKA (Matter SPAKE2+)"
	depends on TF_PSA_CRYPTO_BUILTIN
	help
	  Matter's SPAKE2+ (PASE) calls mbedtls_ecp_mul() and mbedtls_ecp_muladd()
	  directly, past the PSA driver interface. With this on they run on the PKA
	  (ECCMul, ECCDoubleBaseLadder) for P-256. Needs
	  patches/tf-psa-crypto/ecp-p256-stm32-pka.patch applied to tf-psa-crypto;
	  without the patch the option links but changes nothing.

config STM32_PKA_ECP_P256_DEFAULT_ON
	bool "Use the PKA for builtin ECP from boot (shell 'pka ecp on|off')"
	default y
	depends on STM32_PKA_ECP_P256

module = STM32_PKA
module-str = stm32_pka
source "subsys/logging/Kconfig.template.log_config"

endif # STM32_PKA
```

## modules/settings-registry/lib/Kconfig
```kconfig
# Entry point sourced into the global Kconfig tree (via zephyr/module.yml).

menuconfig SETTINGS_REGISTRY
	bool "Generic per-key settings registry"
	select SETTINGS
	help
	  Central per-key settings store for cross-module configuration
	  (network, Matter control, OTA, lock behaviour, keypad feedback, ...).
	  Keys are registered statically at link time (SETTING_REGISTRY_DEFINE),
	  each with its own storage (owned/delegated), mirroring (RAM/direct),
	  persistence (volatile/persistent via Zephyr settings, "reg/" subtree)
	  and change-notification behaviour. See
	  include/settings_registry/settings_registry.h for the full contract.

if SETTINGS_REGISTRY

config SETTINGS_REGISTRY_MAX_SUBSCRIPTIONS
	int "Change-subscription slots (shared pool, all keys)"
	default 16
	help
	  Capacity of the setting_subscribe() slot pool, shared across every
	  registered key. Each subscription gets its own work item on the
	  registry's notification work queue, so slow handlers do not block
	  writers or each other. setting_subscribe() returns NULL when the
	  pool is exhausted.

config SETTINGS_REGISTRY_NOTIFY_WORKQ_STACK_SIZE
	int "Notification work queue stack size"
	default 2048
	help
	  Stack for the registry's dedicated notification work queue
	  (reg_notify_wq): subscriber handlers run on this thread, never on
	  the writer's.

config SETTINGS_REGISTRY_NOTIFY_WORKQ_PRIORITY
	int "Notification work queue thread priority"
	default 10
	help
	  Cooperative/preemptible priority of the notification work queue
	  thread (same convention as the other dedicated queues in this
	  project, e.g. lock_control's notify_wq).

config SETTINGS_REGISTRY_NOTIFY_BUF_SIZE
	int "Per-subscription STRING/BYTES payload snapshot size"
	default 64
	help
	  Each subscription slot carries a buffer of this size for the
	  coalesced STRING/BYTES payload snapshot (delivery is asynchronous,
	  so the writer's buffer cannot be referenced). Longer values are
	  truncated in the notification payload (with a warning); the
	  subscriber can always call setting_get() for the full value.

config SETTINGS_REGISTRY_F32
	bool "Enable SETTING_TYPE_F32 float values"
	default n
	help
	  Adds the float member to struct setting_value and enables the f32
	  range validator. While disabled, a descriptor registered with
	  SETTING_TYPE_F32 is rejected at init, the same way an unknown type
	  would be.

module = SETTINGS_REGISTRY
module-str = settings registry
source "subsys/logging/Kconfig.template.log_config"

endif # SETTINGS_REGISTRY
```

## modules/system-image-store/lib/Kconfig
```kconfig
# Entry point sourced into the global Kconfig tree (via zephyr/module.yml).

menuconfig SYSTEM_IMAGE_STORE
	bool "Staged STM32 image in MCUboot's secondary slot"
	depends on FILE_SYSTEM
	select CRC
	help
	  One upload of the STM32 application (zephyr.signed.bin) written
	  straight into MCUboot slot 2, with durable metadata on the file
	  system: chunks that count only once read back from flash, recovery
	  after a reboot, expiry, and the check of the image itself
	  (mcuboot_image.h). SHA-256 comes from PSA (PSA_WANT_ALG_SHA_256).
	  See include/system_image_store/system_image_store.h.

if SYSTEM_IMAGE_STORE

config SYSTEM_IMAGE_STORE_CHUNK_MAX
	int "Largest chunk, in bytes (the staging buffer)"
	default 16384
	range 512 16384
	help
	  limits.upload_chunk_bytes. One buffer of this size holds the chunk
	  between the HTTP thread and the worker that writes it.

config SYSTEM_IMAGE_STORE_EXPIRE_SECONDS
	int "An upload untouched this long is forgotten, in seconds of uptime"
	default 86400
	range 1 2592000
	help
	  The contract's 24 hours of uptime without activity. Not while an
	  install uses the upload, a chunk is pending or a check runs.

config SYSTEM_IMAGE_STORE_READ_BUF
	int "Read buffer of the check and the read-back, in bytes"
	default 4096
	range 512 16384

config SYSTEM_IMAGE_STORE_SECTOR_MAX
	int "Largest erase sector of the slot, in bytes (the repair buffer)"
	default 4096
	range 512 65536
	help
	  A chunk that begins in the middle of a sector whose remaining bytes
	  cannot be programmed to it keeps the sector's accepted prefix in a
	  buffer of this size while the sector is erased.

config SYSTEM_IMAGE_STORE_STREAM_FLASH
	bool "Write sector-aligned chunks through Zephyr's stream_flash"
	select STREAM_FLASH
	depends on FLASH_HAS_EXPLICIT_ERASE
	help
	  When the platform names the slot's flash device (flash_dev), a chunk
	  that starts on a sector boundary is written by stream_flash: the
	  chunk's sectors are erased through the platform first, then
	  stream_flash programs whole pages from its buffer. Not
	  STREAM_FLASH_ERASE: that option is global and loses data for any
	  stream_flash user whose start is not page-aligned (the coredump
	  backend). A chunk that starts inside a sector still takes the
	  platform's erase/write path, which keeps the sector's accepted bytes.
	  The read-back check is the same for both (owner's request
	  2026-09-19, to compare with the explicit erase-then-write).

config SYSTEM_IMAGE_STORE_TIMING
	bool "Log how long each stage of a chunk takes"
	help
	  One info line per committed chunk: offset, length, and the
	  microseconds spent erasing, programming, reading back and saving the
	  metadata. For measuring where an upload's time goes; off in products.

config SYSTEM_IMAGE_STORE_TLV_MAX
	int "Largest protected + unprotected TLV area accepted, in bytes"
	default 2048
	range 64 16384
	help
	  imgtool without a signature writes a 40-byte TLV area; dependencies
	  and security counters add protected TLVs. A larger area is refused
	  as invalid_image.

module = SYSTEM_IMAGE_STORE
module-str = system_image_store
source "subsys/logging/Kconfig.template.log_config"

endif # SYSTEM_IMAGE_STORE
```
