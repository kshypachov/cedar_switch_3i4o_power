## modules/system-updater/lib/Kconfig
```kconfig
# Entry point sourced into the global Kconfig tree (via zephyr/module.yml).

menuconfig SYSTEM_UPDATER
	bool "STM32 update through MCUboot slot 2 as one job"
	depends on JOB_MANAGER
	help
	  Request a test swap of a verified image in slot 2 and restart; after
	  the swap, reconcile a journal with the image that runs (awaiting
	  confirmation, succeeded, rolled back, failed, interrupted) and
	  confirm the new image once it has run long enough. See
	  include/system_updater/system_updater.h.

if SYSTEM_UPDATER

config SYSTEM_UPDATER_CONFIRM_SECONDS
	int "Seconds a new image runs before it confirms itself"
	default 1200
	range 10 86400
	help
	  Owner's decision (2026-09-14): 20 minutes without a crash. A reset
	  before then makes MCUboot restore the previous image. Shorter values
	  are for the bench.

config SYSTEM_UPDATER_REBOOT_DELAY_MS
	int "Delay between requesting the swap and the restart, ms"
	default 2000
	range 0 60000
	help
	  Lets the HTTP answer and a poll of the job reach the browser before
	  the device goes away.

config SYSTEM_UPDATER_CONFIRM_RETRY_MS
	int "First retry after a failed confirmation, ms"
	default 10000
	range 100 3600000
	help
	  Doubles after each failure up to SYSTEM_UPDATER_CONFIRM_RETRY_MAX_MS.

config SYSTEM_UPDATER_CONFIRM_RETRY_MAX_MS
	int "Longest wait between confirmation retries, ms"
	default 300000
	range 100 3600000

module = SYSTEM_UPDATER
module-str = system-updater
source "subsys/logging/Kconfig.template.log_config"

endif # SYSTEM_UPDATER
```

## modules/web-api/lib/Kconfig
```kconfig
# Entry point sourced into the global Kconfig tree (via zephyr/module.yml).

menuconfig WEB_API
	bool "Web API v1: routing, middleware and JSON"
	select API_VALIDATION
	select WEB_AUTH
	select JOB_MANAGER
	help
	  The contract's request pipeline - Host, session, Origin, CSRF,
	  required headers, body limits and strict JSON, idempotency scope - and
	  the helpers handlers answer with. See include/web_api/web_api.h.

if WEB_API

config WEB_API_JSON_BODY_MAX
	int "Largest JSON request body, in bytes"
	default 8192
	range 512 8192
	help
	  The contract's limit is 8192 and a server may publish less. Bytes past
	  this are counted and discarded, never buffered, and the request is
	  answered 413.

config WEB_API_RESPONSE_BODY_MAX
	int "Largest response body built in RAM, in bytes"
	default 4096
	range 1024 65536
	help
	  Per HTTP client. A handler whose JSON does not fit answers 500 rather
	  than a truncated document.

config WEB_API_DECODED_BODY_MAX
	int "Scratch space a request body decodes into, in bytes"
	default 2048
	range 256 16384
	help
	  Per HTTP client. Every route's decoded struct must fit; that is
	  checked at build time by the route table.

config WEB_API_EXTRA_HOSTS
	string "Host names accepted besides IP literals and localhost"
	default ""
	help
	  Comma-separated, without ports. Requests under /api/ whose Host is not
	  an IP literal, localhost or one of these are refused, which is what
	  keeps a DNS-rebinding page from reading this device's API as
	  same-origin. Add the device's DNS name here if it is reached by name.

config WEB_API_HTTP
	bool "Adapter for Zephyr's HTTP server"
	default y
	depends on HTTP_SERVER && HTTP_SERVER_CAPTURE_HEADERS
	help
	  Header capture, per-client request contexts, body accumulation with
	  the limit, abort, and the mapping of a response onto the server's.

module = WEB_API
module-str = web_api
source "subsys/logging/Kconfig.template.log_config"

endif # WEB_API
```

## modules/web-auth/lib/Kconfig
```kconfig
# Entry point sourced into the global Kconfig tree (via zephyr/module.yml).

menuconfig WEB_AUTH
	bool "Local administrator authentication for the web interface"
	help
	  One administrator, a password stored as a PBKDF2 verifier, cookie
	  sessions with a CSRF token, first-time setup guarded by a setup token,
	  and a limit on password guessing. No HTTP in here: web-api turns the
	  results into responses. See include/web_auth/web_auth.h.

if WEB_AUTH

config WEB_AUTH_MAX_SESSIONS
	int "Concurrent administrator sessions"
	default 4
	range 1 16
	help
	  One per browser the administrator is signed in from. The HTTP server
	  serves at most four clients, and the plan budgets for two browsers, so
	  four leaves room for a phone and a laptop plus one stale tab. When all
	  are taken a new login ends the least recently used one.

config WEB_AUTH_TOMBSTONES
	int "Remembered ended sessions"
	default 8
	range 0 32
	help
	  Tokens of sessions that were logged out, expired, evicted or revoked,
	  kept so that their holder is told session_expired - which the error
	  table marks retryable, because logging in again fixes it - rather than
	  authentication_required, which reads as "you were never signed in".

config WEB_AUTH_IDLE_TIMEOUT_SECONDS
	int "Session idle lifetime, in seconds"
	default 1800
	range 60 86400
	help
	  The contract's starting value is 30 minutes.

config WEB_AUTH_ABSOLUTE_TIMEOUT_SECONDS
	int "Session absolute lifetime, in seconds"
	default 28800
	range 300 604800
	help
	  The contract's starting value is 8 hours. Over plain HTTP a captured
	  cookie is good until this runs out, which is the reason it exists at
	  all.

config WEB_AUTH_PBKDF2_ITERATIONS
	int "PBKDF2-HMAC-SHA256 iterations for newly stored passwords"
	default 3000
	range 1000 1000000
	help
	  Stored with each verifier, so changing it affects only passwords set
	  afterwards. The value is a latency budget, not a security target: the
	  HTTP server's one thread waits for every derivation of a setup, a
	  login and a password check, and answers no other client meanwhile.
	  Measured on the board in P2 (web_auth kdf, PSA Crypto, -Og, SRAM
	  stack): about 0.31 ms per iteration, so 3000 is about 0.94 s and the
	  10000 first chosen was 3.1 s. Online guessing is bounded by the rate
	  limit instead; an offline attack needs the flash in hand.

config WEB_AUTH_PBKDF2_MAX_ITERATIONS
	int "Largest iteration count accepted from a stored verifier"
	default 1000000
	range 1000 10000000
	help
	  A stored verifier claiming more than this is treated as damaged rather
	  than run: a corrupted count must not turn the next login into a
	  minutes-long stall of the whole web server.

config WEB_AUTH_PEER_SLOTS
	int "Clients tracked for failed attempts"
	default 16
	range 1 64

config WEB_AUTH_FREE_FAILURES
	int "Failed attempts a client may make before it is slowed down"
	default 5
	range 1 100
	help
	  A person who mistypes a password a few times is not delayed. After
	  this many consecutive failures from one address each further failure
	  doubles the wait, up to WEB_AUTH_MAX_DELAY_SECONDS.

config WEB_AUTH_MAX_DELAY_SECONDS
	int "Longest wait imposed on one client, in seconds"
	default 300
	range 1 3600

config WEB_AUTH_GLOBAL_FAILURES
	int "Failed attempts from all clients together per window"
	default 30
	range 1 64
	help
	  The per-client limit is keyed by address, and a client on an IPv6
	  network can use as many addresses as it likes. This bounds the total
	  guessing rate regardless. The cost is that a flood of wrong passwords
	  also delays the real administrator until the window passes - a denial
	  of service on a trusted network, chosen over an unbounded guessing
	  rate.

config WEB_AUTH_GLOBAL_WINDOW_SECONDS
	int "Window for the global failure limit, in seconds"
	default 300
	range 10 3600

config WEB_AUTH_PSA_KDF
	bool "PBKDF2 through PSA Crypto"
	default y
	depends on PSA_CRYPTO && PSA_WANT_ALG_PBKDF2_HMAC && PSA_WANT_ALG_SHA_256
	help
	  The production key derivation: psa_key_derivation with
	  PSA_ALG_PBKDF2_HMAC(PSA_ALG_SHA_256). Off in the sim tier's core suite,
	  which injects a fake so it needs no crypto library.

config WEB_AUTH_KDF_STACK_SIZE
	int "Stack of the key derivation thread"
	default 4096
	depends on WEB_AUTH_PSA_KDF
	help
	  PSA Crypto's PBKDF2 runs here. Measured high-water is recorded in
	  the P2 report.

config WEB_AUTH_KDF_THREAD_PRIORITY
	int "Preemptive priority of the key derivation thread"
	default 14
	range 0 14
	depends on WEB_AUTH_PSA_KDF
	help
	  Low on purpose: the derivation takes the CPU only when nothing more
	  urgent is ready. The caller - the HTTP server's cooperative thread -
	  waits for it without holding the CPU. See lib/web_auth_psa.c.

config WEB_AUTH_SHELL
	bool "Shell command to time the key derivation"
	default y
	depends on WEB_AUTH_PSA_KDF && SHELL
	help
	  `web_auth kdf [iterations]` runs one derivation on the production
	  path and prints how long it took: the measurement behind
	  WEB_AUTH_PBKDF2_ITERATIONS. It touches no stored credential.

config WEB_AUTH_REGISTRY_STORE
	bool "Keep the verifier in settings-registry"
	default y
	depends on SETTINGS_REGISTRY
	help
	  The production credential store: one persistent BYTES key,
	  "auth/admin_verifier", read directly rather than mirrored in RAM.

module = WEB_AUTH
module-str = web_auth
source "subsys/logging/Kconfig.template.log_config"

endif # WEB_AUTH
```

## modules/zephyr-log-source/lib/Kconfig
```kconfig
# Entry point sourced into the global Kconfig tree (via zephyr/module.yml).

menuconfig ZEPHYR_LOG_SOURCE
	bool "Zephyr log backend that feeds log-store"
	depends on LOG && LOG_MODE_DEFERRED && LOG_STORE
	select LOG_OUTPUT
	help
	  Every message the Zephyr log core processes becomes an STM32 record
	  in log-store: level and module from the message, the text without
	  timestamp, level or source prefix. Runs on the log processing thread;
	  never logs. See include/zephyr_log_source/zephyr_log_source.h.

	  The log core reports dropped messages to backends only once
	  CONFIG_LOG_FAILURE_REPORT_PERIOD has passed since a moment it moves
	  forward on every processed message (log_core.c), so with the default
	  of 1000 the report stops arriving on a busy system. Set it to 0 for
	  the dropped count to be delivered.

if ZEPHYR_LOG_SOURCE

config ZEPHYR_LOG_SOURCE_RAW_MAX
	int "Formatted message bytes kept before sanitising"
	default 1024
	range 512 8192
	help
	  A message is formatted into this buffer, then made valid UTF-8 and
	  cut to 512 bytes. Replacement characters are three bytes and runs of
	  them collapse, so twice the record's text is enough for anything a
	  record can hold; a longer message is marked truncated.

config ZEPHYR_LOG_SOURCE_INIT_STORE
	bool "Initialise log-store at POST_KERNEL"
	default y
	help
	  The backend reports itself not ready until log-store is initialised,
	  and the log core polls a backend that was not ready from its
	  processing thread. Initialising the store before any thread runs
	  means the thread finds it ready on its first pass and no message
	  written during boot is processed without this backend. Does nothing
	  if the store is already initialised.

endif # ZEPHYR_LOG_SOURCE
```
