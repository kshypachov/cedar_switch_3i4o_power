## docs/device-development/reports/p2/http-server-behaviour/testcase.yaml
```yaml
tests:
  spike.http.hdr32:
    platform_allow: [native_sim/native/64]
    tags: [spike]
  spike.http.hdr256:
    platform_allow: [native_sim/native/64]
    tags: [spike]
    extra_configs:
      - CONFIG_HTTP_SERVER_MAX_HEADER_LEN=256
      - CONFIG_HTTP_SERVER_CAPTURE_HEADER_BUFFER_SIZE=512
```

## modules/api-validation/lib/Kconfig
```kconfig
# Entry point sourced into the global Kconfig tree (via zephyr/module.yml).

menuconfig API_VALIDATION
	bool "Shared validation and error codes for the web API"
	help
	  The contract's error table as code: every rejection gets its code, its
	  HTTP status, its retryable flag, its field paths and its JSON shape
	  from one place, so route handlers cannot drift apart. Also carries the
	  strict parsers the contract needs for addresses and opaque ids. No
	  dynamic allocation and no networking dependency. See
	  include/api_validation/api_validation.h.

if API_VALIDATION

config API_VALIDATION_MAX_FIELDS
	int "Field-level errors carried in one rejection"
	default 6
	range 1 32
	help
	  Each entry costs a path buffer, and an error is meant to live in a
	  request context rather than on a deep stack, so this is deliberately
	  small. Overflow is not silent: the rejection is marked truncated so a
	  client knows the list is partial. Six covers every form in the first
	  version with room to spare.

endif # API_VALIDATION
```

## modules/coprocessor-manager/lib/Kconfig
```kconfig
# Entry point sourced into the global Kconfig tree (via zephyr/module.yml).

menuconfig COPROCESSOR_MANAGER
	bool "Owner of the ESP32-C6's UART and its EN/BOOT lines"
	help
	  One owner of USART3 at a time (console, USB bridge, flasher), the
	  stop-wait-hand-over switch between them, the C6's reset and the
	  generation it starts, and the claims that keep a network apply or
	  scan from colliding with them. The record kinds it writes come from
	  log_store.h; the log-store module must be registered, but its library
	  is not required. See include/coprocessor_manager/coprocessor_manager.h.

if COPROCESSOR_MANAGER

config COPROCESSOR_MANAGER_RX_STOP_TIMEOUT_MS
	int "How long a receive interrupt may take to go quiet, ms"
	default 100
	range 10 5000
	help
	  After the owner's handler is removed, the interrupt counter must stop
	  moving within this time or the switch fails with -ETIMEDOUT and the
	  old owner keeps the UART.

config COPROCESSOR_MANAGER_RX_QUIET_STEP_MS
	int "Interval between two looks at the receive counter, ms"
	default 5
	range 1 100
	help
	  The counter has to be unchanged over two consecutive intervals, so a
	  switch whose interrupt stops at once takes twice this long. That is
	  the switching time the owner asked to keep small.

config COPROCESSOR_MANAGER_RESET_WINDOW_MS
	int "How long a ROM banner counts as the reset that was just made, ms"
	default 3000
	range 0 60000
	help
	  A banner later than this after the manager's own reset (or after
	  init, when the ESP-Hosted driver has just reset the chip) means the
	  C6 restarted by itself and starts a generation.

config COPROCESSOR_MANAGER_EN_PULSE_MS
	int "EN held low for a reset, ms"
	default 100
	help
	  For the board adapter's c6_reset(). The sequence of
	  src/plugin_wifi/wifi.c, which is the one known to work on this board.

config COPROCESSOR_MANAGER_BOOT_HOLD_MS
	int "BOOT strap held after EN is released for a download reset, ms"
	default 200
	help
	  For the board adapter's c6_reset(download). The 200 ms of
	  src/plugin_wifi/wifi.c; esp-serial-flasher's 50 ms default was never
	  exercised on this board.

endif # COPROCESSOR_MANAGER
```

## modules/coprocessor-updater/lib/Kconfig
```kconfig
# Entry point sourced into the global Kconfig tree (via zephyr/module.yml).

menuconfig COPROCESSOR_UPDATER
	bool "UART install of an ESP32-C6 image as one job"
	depends on JOB_MANAGER && COPROCESSOR_MANAGER
	help
	  The contract's install phases, cancellable until begin, a journal
	  that turns an install cut by an STM32 restart into `interrupted`,
	  and a health check that needs a confirmed firmware version. See
	  include/coprocessor_updater/coprocessor_updater.h.

if COPROCESSOR_UPDATER

config COPROCESSOR_UPDATER_READ_BLOCK
	int "Bytes read from the staged image at a time"
	default 4096
	range 256 16384
	help
	  The worker's buffer; progress is published after each block.

config COPROCESSOR_UPDATER_PREFLIGHT_TIMEOUT_MS
	int "preflight: opening the image and checking the UART, ms"
	default 5000

config COPROCESSOR_UPDATER_CONNECT_TIMEOUT_MS
	int "entering_bootloader: straps, SYNC and identification, ms"
	default 15000
	help
	  The device's 10 trials of 100 ms plus the strap sequence take about
	  two seconds on the board (P0); this is the ceiling, not the budget.

config COPROCESSOR_UPDATER_BEGIN_TIMEOUT_MS
	int "begin: FLASH_BEGIN, during which the ROM erases, ms"
	default 60000

config COPROCESSOR_UPDATER_WRITE_TIMEOUT_S
	int "writing: all blocks, seconds"
	default 900
	help
	  1.5 MB at 115200 is about two and a half minutes of data; the ROM's
	  per-block acknowledgements and retries come on top.

config COPROCESSOR_UPDATER_VERIFY_TIMEOUT_MS
	int "verifying: last block and the ROM's MD5, ms"
	default 30000

config COPROCESSOR_UPDATER_RECONNECT_TIMEOUT_MS
	int "reconnecting: waiting for the console to show the application start, ms"
	default 20000
	help
	  The first boot after an erase recalibrates the PHY. When this passes
	  without the evidence, the install goes on to the health check and
	  records that the console showed nothing: the console is the early
	  sign, the version is the proof.

config COPROCESSOR_UPDATER_HEALTH_TIMEOUT_MS
	int "health_check: ESP-Hosted restart and version, ms"
	default 30000

config COPROCESSOR_UPDATER_POLL_MS
	int "Interval between two looks at the console evidence, ms"
	default 200
	range 10 5000

module = COPROCESSOR_UPDATER
module-str = coprocessor-updater
source "subsys/logging/Kconfig.template.log_config"

endif # COPROCESSOR_UPDATER
```

## modules/device-config-store/lib/Kconfig
```kconfig
# Entry point sourced into the global Kconfig tree (via zephyr/module.yml).

menuconfig DEVICE_CONFIG_STORE
	bool "Durable, transactional device configuration store"
	select CRC
	help
	  Versioned storage for the configuration the device must remember
	  across a reboot, with separate committed and pending generations so a
	  network change can be applied, confirmed and committed — or rolled
	  back by a reboot that arrives before the confirmation. Secrets are
	  held apart from the configuration and never appear in a snapshot.
	  Fixed pools, no dynamic allocation, storage backend injected. See
	  include/device_config_store/device_config_store.h.

if DEVICE_CONFIG_STORE

config DEVICE_CONFIG_STORE_LOG_LEVEL
	int "Log level"
	default 3
	range 0 4
	help
	  Standard Zephyr levels: 0 none, 1 error, 2 warning, 3 info, 4 debug.
	  Recovery outcomes are reported at info because "this device rolled
	  back a network change while you were not looking" is the first thing
	  anyone reading a boot log needs to see. Nothing here ever logs a
	  secret, an SSID or an address.

endif # DEVICE_CONFIG_STORE
```

## modules/energy-meter/Kconfig
```kconfig
# Entry point sourced into the global Kconfig tree (via zephyr/module.yml).

config EEPROM_FLASH
	bool "Flash API over an EEPROM device (cedar,eeprom-flash)"
	default y
	depends on DT_HAS_CEDAR_EEPROM_FLASH_ENABLED
	depends on EEPROM && FLASH
	select FLASH_HAS_DRIVER_ENABLED
	select FLASH_HAS_NO_EXPLICIT_ERASE
	select FLASH_HAS_PAGE_LAYOUT
	help
	  Reads and writes go straight to the EEPROM driver in the caller's
	  thread. On this board the FRAM is on SPI1 with DMA, which takes
	  buffers only from SRAM: call it from a thread whose stack is in SRAM.

menuconfig ENERGY_METER
	bool "HLW8032 energy meter, energy counter in ZMS on the FRAM"
	depends on EEPROM_FLASH
	depends on SETTINGS_REGISTRY
	select SERIAL
	select UART_ASYNC_API
	select ZMS
	select SETTINGS_REGISTRY_F32

if ENERGY_METER

config ENERGY_METER_VOLTAGE_DIVIDER
	int "Voltage divider ratio"
	default 1880
	help
	  Upper resistance over the lower one of the voltage channel:
	  4 x 470 kOhm / 1 kOhm = 1880 in the HLW8032 datasheet's typical
	  circuit. The voltage factor is this / 1000.

config ENERGY_METER_SHUNT_UOHM
	int "Current shunt, micro-ohm"
	default 1000
	help
	  1 mOhm in the datasheet's typical circuit.

module = ENERGY_METER
module-str = energy_meter
source "subsys/logging/Kconfig.template.log_config"

endif
```

## modules/energy-meter/dts/bindings/mtd/cedar,eeprom-flash.yaml
```yaml
# Copyright (c) 2026 Cedar
# SPDX-License-Identifier: Apache-2.0

description: |
  The flash API over an EEPROM device, for storage that only speaks flash (ZMS)
  on an SPI FRAM. No erase is needed: the device reports no explicit erase and
  "erase" fills with 0xFF. The size is the EEPROM node's size. Put the
  fixed-partitions under this node.

compatible: "cedar,eeprom-flash"

include: base.yaml

properties:
  eeprom:
    type: phandle
    required: true
    description: The EEPROM device every read and write goes to.
```

## modules/esp-loader-adapter/lib/Kconfig
```kconfig
# Entry point sourced into the global Kconfig tree (via zephyr/module.yml).

menuconfig ESP_LOADER_ADAPTER
	bool "Flashing session over esp-serial-flasher for the ESP32-C6"
	depends on COPROCESSOR_MANAGER
	help
	  Takes the C6's UART from coprocessor-manager, connects to the ROM
	  loader, writes an image from 0x0 with MD5 verification and always
	  hands the chip (normal boot), the straps and the UART back. See
	  include/esp_loader_adapter/esp_loader_adapter.h.

if ESP_LOADER_ADAPTER

config ESP_LOADER_ADAPTER_BLOCK_SIZE
	int "Bytes per FLASH_DATA block"
	default 1024
	range 256 16384
	help
	  The ROM loader's own write size (esptool's FLASH_WRITE_SIZE for the
	  ROM is 0x400). A larger block needs the flasher stub, which the first
	  version does not load.

config ESP_LOADER_ADAPTER_HIGH_BAUD
	int "Baud rate to switch to after connecting, 0 to stay"
	default 0
	help
	  Owner's decision №7: the first flash through the web runs at the
	  device's default rate (115200); a higher rate is measured only after
	  that. 0 keeps the default. The console's configuration is restored
	  when the session closes either way.

DT_CHOSEN_ZEPHYR_ESP_LOADER := zephyr,esp-loader

config ESP_LOADER_ADAPTER_ZEPHYR
	bool "Library table over the zephyr,esp-loader device"
	default y
	depends on ESP_SERIAL_FLASHER
	depends on $(dt_chosen_enabled,$(DT_CHOSEN_ZEPHYR_ESP_LOADER))
	help
	  esp_loader_adapter_zephyr_fill(): the esp_loader_* calls on the
	  chosen espressif,esp-loader device. The board adds lines_idle and
	  console_restore.

config ESP_LOADER_ADAPTER_UPDATER_OPS
	bool "Loader ops for coprocessor-updater"
	default y
	depends on COPROCESSOR_UPDATER
	help
	  esp_loader_adapter_updater_loader(): this module's session as
	  struct coprocessor_updater_loader.

module = ESP_LOADER_ADAPTER
module-str = esp-loader-adapter
source "subsys/logging/Kconfig.template.log_config"

endif # ESP_LOADER_ADAPTER
```

## modules/esp32-log-source/lib/Kconfig
```kconfig
# Entry point sourced into the global Kconfig tree (via zephyr/module.yml).

menuconfig ESP32_LOG_SOURCE
	bool "ESP32-C6 UART bytes to log lines"
	help
	  The pure line assembler behind the ESP32 log source: line ends,
	  ANSI stripping, UTF-8 repair, the 512-byte cap, idle flush of a
	  partial line and ESP-IDF level parsing. The UART interrupt and the
	  store are the board's coprocessor service. See
	  include/esp32_log_source/esp32_log_source.h.

if ESP32_LOG_SOURCE

config ESP32_LOG_SOURCE_IDLE_FLUSH_MS
	int "Flush a partial line after this long without a byte, in ms"
	default 250
	range 10 10000
	help
	  At 115200 baud a byte takes under 0.1 ms, and the C6 ROM prints each
	  line in one go, so a quarter of a second of silence means the line
	  is not going to be finished: a prompt, or output cut by a reset. The
	  value is passed to esp32_log_init() by the caller.

endif # ESP32_LOG_SOURCE
```

## modules/firmware-store/lib/Kconfig
```kconfig
# Entry point sourced into the global Kconfig tree (via zephyr/module.yml).

menuconfig FIRMWARE_STORE
	bool "Staged ESP32-C6 image on the file system"
	depends on FILE_SYSTEM
	select CRC
	help
	  One upload of a full-flash ESP32-C6 image as a file with durable
	  metadata: chunks that count only once synced, recovery after a
	  reboot, a space check before the first byte, expiry, and the check
	  of the image itself (fw_image.h). SHA-256 comes from PSA
	  (PSA_WANT_ALG_SHA_256). See include/firmware_store/firmware_store.h.

if FIRMWARE_STORE

config FIRMWARE_STORE_MAX_BYTES
	int "Largest image accepted, in bytes"
	default 1900544
	range 65537 1900544
	help
	  limits.upload_max_bytes. The default is 0x1d0000: a full-flash file
	  written from 0x0 may not reach ota_1, so nothing larger can be valid.

config FIRMWARE_STORE_CHUNK_MAX
	int "Largest chunk, in bytes (the staging buffer)"
	default 16384
	range 512 16384
	help
	  limits.upload_chunk_bytes. One buffer of this size holds the chunk
	  between the HTTP thread and the worker that writes it.

config FIRMWARE_STORE_RESERVE_KIB
	int "Free space kept beyond the image, in KiB"
	default 256
	range 0 4096
	help
	  An upload is refused unless its missing bytes plus this much are
	  free on the volume, checked at creation and before every chunk.
	  LittleFS appends copy-on-write, and other writers share the volume.

config FIRMWARE_STORE_EXPIRE_SECONDS
	int "An upload untouched this long is removed, in seconds of uptime"
	default 86400
	range 1 2592000
	help
	  The contract's 24 hours of uptime without activity. Not while an
	  install uses the upload, a chunk is pending or a check runs.

config FIRMWARE_STORE_READ_BUF
	int "Read buffer of the image check, in bytes"
	default 4096
	range 512 16384

module = FIRMWARE_STORE
module-str = firmware_store
source "subsys/logging/Kconfig.template.log_config"

endif # FIRMWARE_STORE
```

## modules/flash-sram-proxy/Kconfig
```kconfig
# Entry point sourced into the global Kconfig tree (via zephyr/module.yml).

config FLASH_SRAM_PROXY
	bool "Flash proxy: backend access from an SRAM thread through an SRAM buffer"
	default y
	depends on DT_HAS_CEDAR_FLASH_SRAM_PROXY_ENABLED
	depends on FLASH
	help
	  A flash device (cedar,flash-sram-proxy) that forwards read, write,
	  erase and the JESD216 calls to its backend from its own thread, with
	  data copied through a buffer in SRAM. The backend's SPI driver then
	  only ever sees SRAM (its command buffers on the proxy thread's stack,
	  the data in the proxy buffer), which is what SPI DMA with DCACHE on
	  STM32U5 needs. The library is not relocated to PSRAM (app
	  CMakeLists.txt, src/helpers/psram_sections.ld): keep it that way.

if FLASH_SRAM_PROXY

config FLASH_SRAM_PROXY_BUF_SIZE
	int "Bounce buffer, bytes"
	default 4096
	help
	  Largest piece of one backend read or write. Longer requests are split,
	  so this also sets how many DMA transfers a long read takes.

config FLASH_SRAM_PROXY_STACK_SIZE
	int "Proxy thread stack, bytes"
	default 1024

config FLASH_SRAM_PROXY_THREAD_PRIORITY
	int "Proxy thread priority"
	default 2
	help
	  Callers block until the proxy thread has done their request, so it
	  should not be below any thread that uses the flash.

config FLASH_SRAM_PROXY_INIT_PRIORITY
	int "Init priority (POST_KERNEL)"
	default 90
	help
	  After the backend (SPI_NOR_INIT_PRIORITY, 80) and before anything
	  that mounts a file system or settings on it (FILE_SYSTEM_INIT_PRIORITY,
	  99).

module = FLASH_SRAM_PROXY
module-str = flash_sram_proxy
source "subsys/logging/Kconfig.template.log_config"

endif
```
