## CMakeLists.txt
```
cmake_minimum_required(VERSION 3.20.0)

# The modules under test are not in the west manifest, so register them the
# same way the application does, before find_package(Zephyr).
list(APPEND ZEPHYR_EXTRA_MODULES
    ${CMAKE_CURRENT_SOURCE_DIR}/../../modules/api-validation
    ${CMAKE_CURRENT_SOURCE_DIR}/../../modules/job-manager
    ${CMAKE_CURRENT_SOURCE_DIR}/../../modules/web-auth
    ${CMAKE_CURRENT_SOURCE_DIR}/../../modules/web-api
    ${CMAKE_CURRENT_SOURCE_DIR}/../../modules/matter-service
    ${CMAKE_CURRENT_SOURCE_DIR}/../../modules/device-config-store
    ${CMAKE_CURRENT_SOURCE_DIR}/../../modules/network-manager
    ${CMAKE_CURRENT_SOURCE_DIR}/../../modules/log-store
    ${CMAKE_CURRENT_SOURCE_DIR}/../../modules/coprocessor-manager
    ${CMAKE_CURRENT_SOURCE_DIR}/../../modules/firmware-store
    ${CMAKE_CURRENT_SOURCE_DIR}/../../modules/coprocessor-updater
)

find_package(Zephyr REQUIRED HINTS $ENV{ZEPHYR_BASE})
project(web_api_test)

# The real v1 bindings, not copies: the middleware is tested through the route
# table the device serves. The network bindings run over network-manager with
# the shared interface and storage fakes.
set(V1_DIR ${CMAKE_CURRENT_SOURCE_DIR}/../../src/web/api/v1)
target_include_directories(app PRIVATE ${V1_DIR} ${CMAKE_CURRENT_SOURCE_DIR}/../fakes)
target_sources(app PRIVATE
    src/main.c
    src/middleware.c
    src/v1.c
    src/v1_logs.c
    src/v1_coredump.c
    src/v1_firmware.c
    src/json_reader.c
    src/json_writer.c
    ../fakes/fake_iface.c
    ../fakes/fake_storage.c
    ../fakes/fake_update_platform.c
    ${V1_DIR}/router.c
    ${V1_DIR}/auth.c
    ${V1_DIR}/system.c
    ${V1_DIR}/matter.c
    ${V1_DIR}/network.c
    ${V1_DIR}/logs.c
    ${V1_DIR}/coprocessor.c
    ${V1_DIR}/firmware.c
    ${V1_DIR}/system_update.c
)

# Two files of the synthetic corpus (tests/fixtures/esp32/firmware) as byte arrays,
# for the upload bindings driven end to end (src/v1_firmware.c).
set(FIXTURES ${CMAKE_CURRENT_SOURCE_DIR}/../fixtures/esp32/firmware)
set(GEN_DIR ${ZEPHYR_BINARY_DIR}/include/generated)
foreach(name valid bare_app)
  generate_inc_file_for_target(app ${FIXTURES}/${name}.bin ${GEN_DIR}/fw_${name}.inc)
endforeach()
```

## prj.conf
```kconfig
CONFIG_ZTEST=y
CONFIG_ZTEST_STACK_SIZE=16384
CONFIG_WEB_API=y

# The HTTP server adapter has its own suite (tests/web_api_http); this one
# drives the core with request values.
CONFIG_WEB_API_HTTP=n
CONFIG_WEB_API_EXTRA_HOSTS="cedar.lan, Switch.local"

CONFIG_WEB_AUTH_PSA_KDF=n
CONFIG_WEB_AUTH_REGISTRY_STORE=n
CONFIG_WEB_AUTH_MAX_SESSIONS=4
CONFIG_WEB_AUTH_IDLE_TIMEOUT_SECONDS=60
CONFIG_WEB_AUTH_ABSOLUTE_TIMEOUT_SECONDS=300
CONFIG_WEB_AUTH_PBKDF2_ITERATIONS=1000
CONFIG_WEB_AUTH_FREE_FAILURES=3
CONFIG_WEB_AUTH_MAX_DELAY_SECONDS=8
CONFIG_WEB_AUTH_GLOBAL_FAILURES=32
CONFIG_WEB_AUTH_GLOBAL_WINDOW_SECONDS=60

# The production value; truncation is reached with more bad fields than this.
CONFIG_API_VALIDATION_MAX_FIELDS=6

# The Matter bindings build against matter-service, driven by a fake platform
# where a test needs one; without it the service reports not_ready.
CONFIG_MATTER_SERVICE=y

# The network bindings over the real network-manager and fake interfaces. The
# firmware's response buffer, because a full scan is 64 access points.
CONFIG_NETWORK_MANAGER=y
CONFIG_WEB_API_RESPONSE_BODY_MAX=16384
# ssid_base64 in and out.
CONFIG_BASE64=y

# The log bindings over the real log-store, with rings and a scan budget small
# enough that a wrap, a byte-bounded page and a budget running out take a few
# dozen records (src/v1_logs.c); the coprocessor bindings over the real
# coprocessor-manager on a fake platform.
CONFIG_LOG_STORE=y
CONFIG_LOG_STORE_STM32_KIB=64
CONFIG_LOG_STORE_ESP32_KIB=4
CONFIG_LOG_STORE_SCAN_BUDGET=32
CONFIG_COPROCESSOR_MANAGER=y

# The firmware upload bindings over the real firmware-store, on LittleFS in a
# 1 MiB sim-flash partition (boards/*.overlay, as tests/firmware_store) - too
# small for a 0x1d0000 image, which is the storage_full case - with SHA-256
# through PSA as on the device.
CONFIG_FLASH=y
CONFIG_FLASH_MAP=y
CONFIG_FILE_SYSTEM=y
CONFIG_FILE_SYSTEM_LITTLEFS=y
CONFIG_FS_LITTLEFS_NUM_FILES=8
CONFIG_PSA_CRYPTO=y
CONFIG_MBEDTLS_PSA_STATIC_KEY_SLOTS=y
CONFIG_PSA_WANT_ALG_SHA_256=y
CONFIG_FIRMWARE_STORE=y

# startCoprocessorUpdate over the real coprocessor-updater, on the updater fake
# platform (tests/fakes/fake_update_platform.c) with the staged image read
# through firmware-store (src/v1_firmware.c).
CONFIG_COPROCESSOR_UPDATER=y
```

## src/main.c
```c
/*
 * SPDX-License-Identifier: Apache-2.0
 *
 * Harness for the web-api suites.
 */

#include <string.h>

#include <zephyr/kernel.h>
#include <zephyr/sys/byteorder.h>
#include <zephyr/ztest.h>

#include <job_manager/job_manager.h>

#include "harness.h"

struct web_api_context ctx;
char body[CONFIG_WEB_API_RESPONSE_BODY_MAX + 1];
int64_t fake_now;
bool kdf_gate_enabled;
K_SEM_DEFINE(kdf_gate, 0, 1);
int kdf_calls;

static uint32_t random_counter;
static uint8_t store[128];
static size_t store_len;
static bool store_present;
static k_tid_t test_thread;
static char query_buf[256];
static char path_buf[256];

static int64_t clock_fn(void)
{
	return fake_now;
}

static int random_fn(uint8_t *buf, size_t len)
{
	for (size_t i = 0; i < len; i++) {
		random_counter = random_counter * 1103515245U + 12345U;
		buf[i] = (uint8_t)(random_counter >> 16);
	}
	return 0;
}

static int kdf_fn(const uint8_t *password, size_t password_len, const uint8_t *salt,
		  size_t salt_len, uint32_t iterations, uint8_t *out, size_t out_len)
{
	uint64_t h = 0xcbf29ce484222325ULL ^ iterations;

	kdf_calls++;
	if (kdf_gate_enabled && k_current_get() != test_thread) {
		k_sem_take(&kdf_gate, K_FOREVER);
	}
	for (size_t i = 0; i < password_len; i++) {
		h = (h ^ password[i]) * 0x100000001b3ULL;
	}
	for (size_t i = 0; i < salt_len; i++) {
		h = (h ^ salt[i]) * 0x100000001b3ULL;
	}
	for (size_t i = 0; i < out_len; i++) {
		h = (h ^ i) * 0x100000001b3ULL;
		out[i] = (uint8_t)(h >> 29);
	}
	return 0;
}

static int load_fn(uint8_t *buf, size_t cap, size_t *out_len)
{
	if (!store_present) {
		return -ENOENT;
	}
	memcpy(buf, store, store_len);
	*out_len = store_len;
	return 0;
}

static int save_fn(const uint8_t *buf, size_t len)
{
	memcpy(store, buf, len);
	store_len = len;
	store_present = true;
	return 0;
}

const struct web_auth_platform fake_platform = {
	.random = random_fn,
	.now_ms = clock_fn,
	.kdf = kdf_fn,
	.load_verifier = load_fn,
	.save_verifier = save_fn,
};

void harness_reset(void)
{
	test_thread = k_current_get();
	fake_now = 1000;
	random_counter = 3;
	store_present = false;
	store_len = 0;
	kdf_calls = 0;
	kdf_gate_enabled = false;
	k_sem_reset(&kdf_gate);
	job_manager_init();
	zassert_ok(web_auth_init(&fake_platform));
}

void request(enum web_api_method method, const char *path)
{
	const char *q = strchr(path, '?');

	memset(&ctx.req, 0, sizeof(ctx.req));
	if (q != NULL) {
		size_t n = (size_t)(q - path);

		memcpy(path_buf, path, n);
		path_buf[n] = '\0';
		strcpy(query_buf, q + 1);
		ctx.req.path = path_buf;
		ctx.req.query = query_buf;
	} else {
		strcpy(path_buf, path);
		ctx.req.path = path_buf;
		ctx.req.query = "";
	}
	ctx.req.method = method;
	ctx.req.headers.host = "192.168.88.14";
	ctx.req.peer.family = 4;
	ctx.req.peer.addr[0] = 192;
	ctx.req.peer.addr[1] = 168;
	ctx.req.peer.addr[2] = 88;
	ctx.req.peer.addr[3] = 17;
}

void request_body(const char *json)
{
	size_t n = strlen(json);

	zassert_true(n <= sizeof(ctx.body));
	memcpy(ctx.body, json, n);
	ctx.req.body = ctx.body;
	ctx.req.body_len = n;
	ctx.req.body_received = n;
}

void request_octets(const uint8_t *data, size_t n, const char *content_type)
{
	zassert_true(n <= sizeof(ctx.body));
	memcpy(ctx.body, data, n);
	ctx.req.body = ctx.body;
	ctx.req.body_len = n;
	ctx.req.body_received = n;
	ctx.req.headers.content_type = content_type;
}

void dispatch(const struct web_api_router *router)
{
	web_api_dispatch(router, &ctx);
	memset(body, 0, sizeof(body));
	if (ctx.rsp.body != NULL) {
		memcpy(body, ctx.rsp.body, MIN(ctx.rsp.body_len, sizeof(body) - 1));
	}
	/* Every API response carries these, whatever the outcome. */
	zassert_not_null(response_header("X-Request-ID"));
	zassert_str_equal(response_header("Cache-Control"), "no-store");
	if (ctx.rsp.status >= 400) {
		char expected[96];

		snprintf(expected, sizeof(expected), "\"request_id\":\"%s\"",
			 response_header("X-Request-ID"));
		zassert_true(strstr(body, expected) != NULL,
			     "a rejection's request_id is its header's: %s", body);
		zassert_str_equal(response_header("Content-Type"), "application/json");
	}
}

const char *response_header(const char *name)
{
	for (size_t i = 0; i < ctx.rsp.header_count; i++) {
		if (strcmp(ctx.rsp.headers[i].name, name) == 0) {
			return ctx.rsp.headers[i].value;
		}
	}
	return NULL;
}

bool body_has(const char *fragment)
{
	return strstr(body, fragment) != NULL;
}
```

## src/harness.h
```c
/*
 * SPDX-License-Identifier: Apache-2.0
 *
 * Shared by the web-api suites: a fake web-auth platform, and a way to send a
 * request value through a router and read the response back.
 */

#ifndef WEB_API_TEST_HARNESS_H_
#define WEB_API_TEST_HARNESS_H_

#include <stdbool.h>

#include <web_api/web_api.h>
#include <web_auth/web_auth.h>

extern struct web_api_context ctx;
/* The response body, NUL-terminated. */
extern char body[CONFIG_WEB_API_RESPONSE_BODY_MAX + 1];

extern int64_t fake_now;
/* While set, the fake key derivation on any thread but the test's blocks on
 * kdf_gate: a password change job can be held running. */
extern bool kdf_gate_enabled;
extern struct k_sem kdf_gate;
extern int kdf_calls;

extern const struct web_auth_platform fake_platform;

void harness_reset(void);

/* Start a request: Host is a LAN address, everything else empty. */
void request(enum web_api_method method, const char *path);
void request_body(const char *json);
/* A raw body with @p content_type (NULL: no Content-Type header). */
void request_octets(const uint8_t *data, size_t n, const char *content_type);
void dispatch(const struct web_api_router *router);

const char *response_header(const char *name);
/* The value of "name": in the body, as raw JSON text up to , or } */
bool body_has(const char *fragment);

/* Empty log-store, and coprocessor-manager on a fake platform with the console
 * owning the UART and no transport (src/v1_logs.c). */
void v1_coprocessor_fake_init(void);

/* coprocessor-updater on its fake platform with no journal and no last install
 * (src/v1_firmware.c). */
void v1_update_fake_reset(void);

#endif
```

## src/json_reader.c
```c
/*
 * SPDX-License-Identifier: Apache-2.0
 *
 * Strict request decoding: every syntax refusal is invalid_json, every schema
 * refusal names its field, and the field list is the same one the mock
 * produces for the same body.
 */

#include <string.h>

#include <zephyr/ztest.h>

#include <web_api/json_reader.h>

struct inner {
	int64_t level;
	bool on;
};

struct item {
	char label[9];
};

struct doc {
	char name[17];
	bool name_present;
	char note[9];
	bool note_null;
	int64_t count;
	bool flag;
	char mode[8];
	char addr[16];
	struct inner inner;
	struct item items[3];
	size_t item_count;
	char tiny[4]; /* 3 bytes of text, but up to 8 code points by the schema */
};

static const char *const modes[] = {"dhcp", "static", NULL};

static bool is_dotted(const char *v)
{
	return strchr(v, '.') != NULL;
}

static const struct web_json_field inner_fields[] = {
	{.name = "level", .type = WEB_JSON_INT, .flags = WEB_JSON_REQUIRED,
	 .offset = offsetof(struct inner, level), .min = -5, .max = 5},
	{.name = "on", .type = WEB_JSON_BOOL, .offset = offsetof(struct inner, on)},
};
static const struct web_json_object inner_schema = {inner_fields, ARRAY_SIZE(inner_fields)};

static const struct web_json_field item_field = {
	.type = WEB_JSON_STRING, .offset = offsetof(struct item, label), .size = 9, .max_len = 8,
};

static const struct web_json_field doc_fields[] = {
	{.name = "name", .type = WEB_JSON_STRING, .flags = WEB_JSON_REQUIRED | WEB_JSON_PRESENT,
	 .offset = offsetof(struct doc, name), .present_offset = offsetof(struct doc, name_present),
	 .size = 17, .min_len = 2, .max_len = 16},
	{.name = "note", .type = WEB_JSON_STRING, .flags = WEB_JSON_NULLABLE,
	 .offset = offsetof(struct doc, note), .null_offset = offsetof(struct doc, note_null),
	 .size = 9, .max_len = 8},
	{.name = "count", .type = WEB_JSON_INT, .offset = offsetof(struct doc, count),
	 .min = INT64_MIN, .max = 1000},
	{.name = "flag", .type = WEB_JSON_BOOL, .offset = offsetof(struct doc, flag)},
	{.name = "mode", .type = WEB_JSON_STRING, .offset = offsetof(struct doc, mode), .size = 8,
	 .max_len = 7, .enum_values = modes},
	{.name = "addr", .type = WEB_JSON_STRING, .offset = offsetof(struct doc, addr), .size = 16,
	 .max_len = 15, .format = is_dotted},
	{.name = "inner", .type = WEB_JSON_OBJECT, .offset = offsetof(struct doc, inner),
	 .object = &inner_schema},
	{.name = "items", .type = WEB_JSON_ARRAY, .offset = offsetof(struct doc, items),
	 .items = &item_field, .item_size = sizeof(struct item),
	 .count_offset = offsetof(struct doc, item_count), .min_len = 1, .max_len = 3},
	{.name = "tiny", .type = WEB_JSON_STRING, .offset = offsetof(struct doc, tiny), .size = 4,
	 .max_len = 8},
};
static const struct web_json_object doc_schema = {doc_fields, ARRAY_SIZE(doc_fields)};

static struct doc d;
static struct api_error err;

static int decode(const char *json)
{
	memset(&err, 0, sizeof(err));
	return web_json_decode(json, strlen(json), &doc_schema, &d, sizeof(d), &err);
}

static void expect_syntax(const char *json)
{
	zassert_equal(decode(json), -EBADMSG, "should be invalid_json: %s", json);
	zassert_equal(err.code, API_ERR_INVALID_JSON, "%s", json);
	zassert_equal(err.field_count, 0);
}

/* Expect validation_failed with exactly these path=code pairs, in order. */
static void expect_fields(const char *json, size_t n, const char *const pairs[][2])
{
	zassert_equal(decode(json), -EINVAL, "should be validation_failed: %s", json);
	zassert_equal(err.code, API_ERR_VALIDATION_FAILED);
	zassert_equal(err.field_count, n, "%s: %u fields", json, err.field_count);
	for (size_t i = 0; i < n; i++) {
		zassert_str_equal(err.fields[i].path, pairs[i][0], "%s: field %zu", json, i);
		zassert_str_equal(api_field_code_str(err.fields[i].code), pairs[i][1],
				  "%s: field %zu (%s)", json, i, pairs[i][0]);
	}
}

#define FIELDS(...) ((const char *const[][2]){__VA_ARGS__})
#define EXPECT_FIELDS(json, ...)                                                                   \
	expect_fields(json, sizeof(FIELDS(__VA_ARGS__)) / sizeof(FIELDS(__VA_ARGS__)[0]),          \
		      FIELDS(__VA_ARGS__))

ZTEST_SUITE(json_reader, NULL, NULL, NULL, NULL, NULL);

ZTEST(json_reader, test_full_document)
{
	zassert_ok(decode("{\"name\":\"ab\",\"note\":\"n\",\"count\":-7,\"flag\":true,"
			  "\"mode\":\"static\",\"addr\":\"1.2\",\"inner\":{\"level\":5,\"on\":true},"
			  "\"items\":[\"x\",\"yy\"],\"tiny\":\"abc\"}"));
	zassert_str_equal(d.name, "ab");
	zassert_true(d.name_present);
	zassert_str_equal(d.note, "n");
	zassert_false(d.note_null);
	zassert_equal(d.count, -7);
	zassert_true(d.flag);
	zassert_str_equal(d.mode, "static");
	zassert_str_equal(d.addr, "1.2");
	zassert_equal(d.inner.level, 5);
	zassert_true(d.inner.on);
	zassert_equal(d.item_count, 2);
	zassert_str_equal(d.items[0].label, "x");
	zassert_str_equal(d.items[1].label, "yy");
	zassert_str_equal(d.tiny, "abc");
}

ZTEST(json_reader, test_absent_members_read_as_zero)
{
	memset(&d, 0x5A, sizeof(d));
	zassert_ok(decode(" {\"name\" : \"ab\"}\r\n\t "));
	zassert_equal(d.count, 0);
	zassert_false(d.flag);
	zassert_equal(d.note[0], '\0');
	zassert_equal(d.item_count, 0);
	zassert_false(d.note_null);
}

ZTEST(json_reader, test_null)
{
	zassert_ok(decode("{\"name\":\"ab\",\"note\":null}"));
	zassert_true(d.note_null);
	EXPECT_FIELDS("{\"name\":null}", {"/name", "invalid_format"});
	EXPECT_FIELDS("{\"name\":\"ab\",\"count\":null}", {"/count", "invalid_format"});
}

ZTEST(json_reader, test_present_flag_is_opt_in)
{
	/* "note" has no WEB_JSON_PRESENT; its zero present_offset must not have
	 * written into the first byte of "name". */
	zassert_ok(decode("{\"note\":\"x\",\"name\":\"ab\"}"));
	zassert_str_equal(d.name, "ab");
}

ZTEST(json_reader, test_syntax_refusals)
{
	static const char *const bad[] = {
		"",
		"   ",
		"{",
		"}",
		"{\"name\":\"ab\"",
		"{\"name\":\"ab\",}",
		"{,\"name\":\"ab\"}",
		"{\"name\" \"ab\"}",
		"{name:\"ab\"}",
		"{'name':'ab'}",
		"{\"name\":\"ab\"} x",
		"{\"name\":\"ab\"}{}",
		"{\"count\":01}",
		"{\"count\":-}",
		"{\"count\":1.}",
		"{\"count\":.5}",
		"{\"count\":1e}",
		"{\"count\":+1}",
		"{\"count\":0x10}",
		"{\"flag\":tru}",
		"{\"flag\":True}",
		"{\"note\":nul}",
		"{\"name\":\"a\nb\"}",
		"{\"name\":\"a\\qb\"}",
		"{\"name\":\"a\\u12G4\"}",
		"{\"name\":\"a\\u12\"}",
		"{\"name\":\"ab}",
		"{\"items\":[\"a\",]}",
		"{\"items\":[\"a\" \"b\"]}",
		"[1,2",
	};

	for (size_t i = 0; i < ARRAY_SIZE(bad); i++) {
		expect_syntax(bad[i]);
	}
}

ZTEST(json_reader, test_invalid_utf8_is_syntax)
{
	static const char *const bad[] = {
		"{\"name\":\"\xC0\xAF\"}",     /* overlong */
		"{\"name\":\"\x80\"}",         /* lone continuation */
		"{\"name\":\"\xE2\x82\"}",     /* truncated */
		"{\"name\":\"\xED\xA0\x80\"}", /* encoded surrogate */
		"{\"name\":\"\xF4\x90\x80\x80\"}", /* past U+10FFFF */
		"{\"name\":\"\xFF\"}",
		"{\"\xC0\xAF\":1}",
	};

	for (size_t i = 0; i < ARRAY_SIZE(bad); i++) {
		expect_syntax(bad[i]);
	}
}

ZTEST(json_reader, test_duplicate_names_are_syntax)
{
	expect_syntax("{\"name\":\"ab\",\"name\":\"cd\"}");
	expect_syntax("{\"name\":\"ab\",\"x\":1,\"x\":2}");
	expect_syntax("{\"name\":\"ab\",\"inner\":{\"level\":1,\"level\":2}}");
	expect_syntax("{\"name\":\"ab\",\"x\":{\"a\":1,\"a\":1}}");
	/* Spelled differently, the same name. */
	expect_syntax("{\"name\":\"ab\",\"n\\u0061me\":\"cd\"}");
}

ZTEST(json_reader, test_syntax_error_wins_over_schema_errors)
{
	/* Schema problems first, then a break: still invalid_json. */
	expect_syntax("{\"extra\":1,\"count\":\"x\",\"name\":");
	zassert_equal(d.count, 0, "nothing is left in the destination");
}

ZTEST(json_reader, test_depth)
{
	char deep[64] = "{\"name\":\"ab\",\"x\":";
	size_t n = strlen(deep);

	/* The document is level 1; seven more fit, the eighth does not. */
	for (int i = 0; i < WEB_JSON_MAX_DEPTH - 1; i++) {
		deep[n++] = '[';
	}
	for (int i = 0; i < WEB_JSON_MAX_DEPTH - 1; i++) {
		deep[n++] = ']';
	}
	deep[n++] = '}';
	deep[n] = '\0';
	EXPECT_FIELDS(deep, {"/x", "unknown_field"});

	strcpy(deep, "{\"name\":\"ab\",\"x\":");
	n = strlen(deep);
	for (int i = 0; i < WEB_JSON_MAX_DEPTH; i++) {
		deep[n++] = '[';
	}
	for (int i = 0; i < WEB_JSON_MAX_DEPTH; i++) {
		deep[n++] = ']';
	}
	deep[n++] = '}';
	deep[n] = '\0';
	expect_syntax(deep);
}

ZTEST(json_reader, test_top_level_must_be_an_object)
{
	EXPECT_FIELDS("[]", {"/", "invalid_format"});
	EXPECT_FIELDS("null", {"/", "invalid_format"});
	EXPECT_FIELDS(" \"x\" ", {"/", "invalid_format"});
	EXPECT_FIELDS("12", {"/", "invalid_format"});
}

ZTEST(json_reader, test_required_and_unknown)
{
	EXPECT_FIELDS("{}", {"/name", "required"});
	EXPECT_FIELDS("{\"zeta\":1,\"name\":\"ab\",\"alpha\":{\"a\":[1,2]}}",
		      {"/alpha", "unknown_field"}, {"/zeta", "unknown_field"});
	EXPECT_FIELDS("{\"name\":\"ab\",\"inner\":{\"x\":true}}", {"/inner/level", "required"},
		      {"/inner/x", "unknown_field"});
}

ZTEST(json_reader, test_wrong_types)
{
	EXPECT_FIELDS("{\"name\":1,\"count\":\"1\",\"flag\":0,\"inner\":[],\"items\":{},\"mode\":true}",
		      {"/count", "invalid_format"}, {"/flag", "invalid_format"},
		      {"/inner", "invalid_format"}, {"/items", "invalid_format"},
		      {"/mode", "invalid_format"}, {"/name", "invalid_format"});
}

ZTEST(json_reader, test_string_lengths_are_code_points)
{
	/* 16 Cyrillic letters: 32 bytes, 16 code points - fits a 17-byte buffer?
	 * No: the buffer is bytes. "name" is 17 bytes, so this is too_long by
	 * buffer even though it is within max_len by code points. */
	EXPECT_FIELDS("{\"name\":\"абвгдежзийклмноп\"}", {"/name", "too_long"});
	/* 8 Cyrillic letters: 16 bytes, fits. */
	zassert_ok(decode("{\"name\":\"абвгдежз\"}"));
	zassert_str_equal(d.name, "абвгдежз");
	/* 17 ASCII: too long by code points. */
	EXPECT_FIELDS("{\"name\":\"abcdefghijklmnopq\"}", {"/name", "too_long"});
	/* One code point: below min_len 2. A four-byte character is still one. */
	EXPECT_FIELDS("{\"name\":\"\xF0\x9F\x94\x91\"}", {"/name", "out_of_range"});
	zassert_ok(decode("{\"name\":\"\xF0\x9F\x94\x91\xF0\x9F\x94\x91\"}"));
	/* "tiny": within max_len by code points but not by its 4-byte buffer. */
	EXPECT_FIELDS("{\"name\":\"ab\",\"tiny\":\"abcd\"}", {"/tiny", "too_long"});
}

ZTEST(json_reader, test_escapes_decode)
{
	zassert_ok(decode("{\"name\":\"\\\"\\\\\\/\\b\\f\\n\\r\\t\"}"));
	zassert_mem_equal(d.name, "\"\\/\b\f\n\r\t", 8);
	zassert_ok(decode("{\"name\":\"\\u00e9\\u20AC\\ud83d\\ude00\"}"));
	zassert_str_equal(d.name, "é€\xF0\x9F\x98\x80");
}

ZTEST(json_reader, test_text_c_cannot_hold)
{
	EXPECT_FIELDS("{\"name\":\"a\\u0000b\"}", {"/name", "invalid_format"});
	EXPECT_FIELDS("{\"name\":\"ab\\ud800\"}", {"/name", "invalid_format"});
	EXPECT_FIELDS("{\"name\":\"ab\\udc00x\"}", {"/name", "invalid_format"});
	EXPECT_FIELDS("{\"name\":\"a\\ud800\\u0041\"}", {"/name", "invalid_format"});
}

ZTEST(json_reader, test_enum_and_format)
{
	EXPECT_FIELDS("{\"name\":\"ab\",\"mode\":\"auto\"}", {"/mode", "not_allowed"});
	EXPECT_FIELDS("{\"name\":\"ab\",\"mode\":\"DHCP\"}", {"/mode", "not_allowed"});
	EXPECT_FIELDS("{\"name\":\"ab\",\"addr\":\"nodots\"}", {"/addr", "invalid_format"});
	/* Precedence: too_long before format. */
	EXPECT_FIELDS("{\"name\":\"ab\",\"addr\":\"nodotsnodotsnodots\"}", {"/addr", "too_long"});
}

ZTEST(json_reader, test_integers_are_values)
{
	static const struct {
		const char *text;
		int64_t value;
	} ok[] = {
		{"0", 0},       {"-0", 0},     {"120", 120},     {"120.0", 120},
		{"1.2e2", 120}, {"12E1", 120}, {"1200e-1", 120}, {"0.0e5", 0},
		{"-9223372036854775808", INT64_MIN}, {"1000", 1000}, {"100e-2", 1},
		{"0.000", 0},
	};
	static const char *const fractional[] = {"1.5", "12e-1", "0.001", "-0.5"};
	static const char *const range[] = {"1001", "9223372036854775808", "1e19", "1e100000",
					    "-9223372036854775809"};
	char json[80];

	for (size_t i = 0; i < ARRAY_SIZE(ok); i++) {
		snprintf(json, sizeof(json), "{\"name\":\"ab\",\"count\":%s}", ok[i].text);
		zassert_ok(decode(json), "%s", json);
		zassert_equal(d.count, ok[i].value, "%s", ok[i].text);
	}
	for (size_t i = 0; i < ARRAY_SIZE(fractional); i++) {
		snprintf(json, sizeof(json), "{\"name\":\"ab\",\"count\":%s}", fractional[i]);
		EXPECT_FIELDS(json, {"/count", "invalid_format"});
	}
	for (size_t i = 0; i < ARRAY_SIZE(range); i++) {
		snprintf(json, sizeof(json), "{\"name\":\"ab\",\"count\":%s}", range[i]);
		EXPECT_FIELDS(json, {"/count", "out_of_range"});
	}
	EXPECT_FIELDS("{\"name\":\"ab\",\"inner\":{\"level\":-6}}", {"/inner/level", "out_of_range"});
}

/*
 * The two oneOf values of the network request, CredentialChange and a DNS
 * server: the mock names the value, not what is wrong inside it
 * (tools/api-contract/tests/test_mock_network.py, the malformed credential and
 * the resolver that is not an address).
 */
struct credential {
	char action[9];
	char value[9];
	bool value_present;
};

struct oneof_doc {
	struct credential cred;
	char servers[2][8];
	size_t server_count;
	int64_t other;
};

static const char *const actions[] = {"keep", "replace", "clear", NULL};

static const struct web_json_field credential_fields[] = {
	{.name = "action", .type = WEB_JSON_STRING, .flags = WEB_JSON_REQUIRED,
	 .offset = offsetof(struct credential, action), .size = 9, .max_len = 8,
	 .enum_values = actions},
	{.name = "value", .type = WEB_JSON_STRING, .flags = WEB_JSON_PRESENT,
	 .offset = offsetof(struct credential, value),
	 .present_offset = offsetof(struct credential, value_present), .size = 9, .min_len = 1,
	 .max_len = 8},
};
static const struct web_json_object credential_schema = {credential_fields,
							  ARRAY_SIZE(credential_fields)};

static const struct web_json_field server_field = {
	.type = WEB_JSON_STRING, .flags = WEB_JSON_ONEOF, .offset = 0, .size = 8, .max_len = 7,
	.format = is_dotted,
};

static const struct web_json_field oneof_fields[] = {
	{.name = "cred", .type = WEB_JSON_OBJECT, .flags = WEB_JSON_ONEOF,
	 .offset = offsetof(struct oneof_doc, cred), .object = &credential_schema},
	{.name = "servers", .type = WEB_JSON_ARRAY, .offset = offsetof(struct oneof_doc, servers),
	 .items = &server_field, .item_size = 8,
	 .count_offset = offsetof(struct oneof_doc, server_count), .max_len = 2},
	{.name = "other", .type = WEB_JSON_INT, .offset = offsetof(struct oneof_doc, other),
	 .min = 0, .max = 9},
};
static const struct web_json_object oneof_schema = {oneof_fields, ARRAY_SIZE(oneof_fields)};

static void expect_oneof(const char *json, size_t n, const char *const pairs[][2])
{
	struct oneof_doc o;

	memset(&err, 0, sizeof(err));
	zassert_equal(web_json_decode(json, strlen(json), &oneof_schema, &o, sizeof(o), &err),
		      -EINVAL, "%s", json);
	zassert_equal(err.field_count, n, "%s: %u fields", json, err.field_count);
	for (size_t i = 0; i < n; i++) {
		zassert_str_equal(err.fields[i].path, pairs[i][0], "%s: field %zu", json, i);
		zassert_str_equal(api_field_code_str(err.fields[i].code), pairs[i][1],
				  "%s: field %zu (%s)", json, i, pairs[i][0]);
	}
}

#define EXPECT_ONEOF(json, ...)                                                                    \
	expect_oneof(json, sizeof(FIELDS(__VA_ARGS__)) / sizeof(FIELDS(__VA_ARGS__)[0]),           \
		     FIELDS(__VA_ARGS__))

ZTEST(json_reader, test_oneof_values_are_one_conflicting_entry)
{
	struct oneof_doc o;
	const char *ok = "{\"cred\":{\"action\":\"replace\",\"value\":\"secret\"},"
			 "\"servers\":[\"1.2\",\"3.4\"]}";

	memset(&err, 0, sizeof(err));
	zassert_ok(web_json_decode(ok, strlen(ok), &oneof_schema, &o, sizeof(o), &err));
	zassert_str_equal(o.cred.value, "secret");
	zassert_true(o.cred.value_present);
	zassert_equal(o.server_count, 2);

	EXPECT_ONEOF("{\"cred\":{}}", {"/cred", "conflicting"});
	EXPECT_ONEOF("{\"cred\":{\"action\":\"sometimes\"}}", {"/cred", "conflicting"});
	EXPECT_ONEOF("{\"cred\":{\"action\":\"keep\",\"stray\":1}}", {"/cred", "conflicting"});
	EXPECT_ONEOF("{\"cred\":{\"action\":\"replace\",\"value\":\"much too long\"}}",
		     {"/cred", "conflicting"});
	EXPECT_ONEOF("{\"cred\":\"keep\"}", {"/cred", "conflicting"});
	EXPECT_ONEOF("{\"cred\":null}", {"/cred", "conflicting"});
	EXPECT_ONEOF("{\"servers\":[\"name\",53]}", {"/servers/0", "conflicting"},
		     {"/servers/1", "conflicting"});

	/* Only the oneOf value collapses; its neighbours report as usual. */
	EXPECT_ONEOF("{\"cred\":{\"x\":1},\"other\":10,\"extra\":1}", {"/cred", "conflicting"},
		     {"/extra", "unknown_field"}, {"/other", "out_of_range"});

	/* A syntax error inside is still a syntax error. */
	memset(&err, 0, sizeof(err));
	zassert_equal(web_json_decode("{\"cred\":{\"action\":}", 19, &oneof_schema, &o, sizeof(o),
				      &err),
		      -EBADMSG);
}

/*
 * What a oneOf value would have reported goes entirely, including the fact that
 * there was too much of it to collect: the value is one conflicting entry and
 * the list is complete. Found by mutation: no oneOf value tested produced more
 * reports than the reader collects, so keeping the truncation broke nothing.
 */
ZTEST(json_reader, test_a_oneof_value_does_not_leave_truncation_behind)
{
	struct oneof_doc o;
	char json[512];
	size_t pos = 0;

	/* 40 unknown members inside the credential: more than the 32 collected. */
	pos += snprintf(json + pos, sizeof(json) - pos, "{\"cred\":{");
	for (int i = 0; i < 40; i++) {
		pos += snprintf(json + pos, sizeof(json) - pos, "%s\"k%02d\":1", i ? "," : "", i);
	}
	pos += snprintf(json + pos, sizeof(json) - pos, "}}");
	zassert_true(pos < sizeof(json));

	memset(&err, 0, sizeof(err));
	zassert_equal(web_json_decode(json, pos, &oneof_schema, &o, sizeof(o), &err), -EINVAL);
	zassert_equal(err.field_count, 1);
	zassert_str_equal(err.fields[0].path, "/cred");
	zassert_equal(err.fields[0].code, API_FIELD_CONFLICTING);
	zassert_false(err.fields_truncated, "one entry is the whole list");
}

ZTEST(json_reader, test_arrays)
{
	EXPECT_FIELDS("{\"name\":\"ab\",\"items\":[]}", {"/items", "out_of_range"});
	EXPECT_FIELDS("{\"name\":\"ab\",\"items\":[\"a\",\"b\",\"c\",\"d\"]}",
		      {"/items", "out_of_range"});
	zassert_equal(d.item_count, 0, "nothing kept from a rejected body");

	EXPECT_FIELDS("{\"name\":\"ab\",\"items\":[\"a\",1,\"toolongvalue\"]}",
		      {"/items/1", "invalid_format"}, {"/items/2", "too_long"});
}

ZTEST(json_reader, test_fields_sort_by_path_segments)
{
	/* 11 elements in a 3-element array: only the first three are decoded,
	 * but ordering must put /items/10 after /items/2 - here we use nested
	 * member names to check segment-wise comparison instead. */
	EXPECT_FIELDS("{\"name\":\"ab\",\"inner\":{\"on\":1,\"level\":\"x\"},\"count\":\"x\","
		      "\"aa\":1,\"inn\":1}",
		      {"/aa", "unknown_field"}, {"/count", "invalid_format"},
		      {"/inn", "unknown_field"}, {"/inner/level", "invalid_format"},
		      {"/inner/on", "invalid_format"});
}

ZTEST(json_reader, test_numeric_segments_compare_as_numbers)
{
	static const struct web_json_field many_item = {
		.type = WEB_JSON_BOOL, .offset = 0,
	};
	struct many {
		bool v[12];
		size_t n;
	} m;
	const struct web_json_field many_fields[] = {
		{.name = "v", .type = WEB_JSON_ARRAY, .offset = offsetof(struct many, v),
		 .items = &many_item, .item_size = sizeof(bool),
		 .count_offset = offsetof(struct many, n), .max_len = 12},
	};
	const struct web_json_object many_schema = {many_fields, 1};
	const char *json = "{\"v\":[true,true,1,true,true,true,true,true,true,true,1,true]}";

	zassert_equal(web_json_decode(json, strlen(json), &many_schema, &m, sizeof(m), &err),
		      -EINVAL);
	zassert_equal(err.field_count, 2);
	zassert_str_equal(err.fields[0].path, "/v/2");
	zassert_str_equal(err.fields[1].path, "/v/10");
}

ZTEST(json_reader, test_truncation)
{
	zassert_equal(decode("{\"a\":1,\"b\":1,\"c\":1,\"d\":1,\"e\":1,\"f\":1,\"g\":1}"), -EINVAL);
	zassert_equal(err.field_count, CONFIG_API_VALIDATION_MAX_FIELDS);
	zassert_true(err.fields_truncated);
	/* Sorted before truncating: the survivors are the first by path. */
	zassert_str_equal(err.fields[0].path, "/a");
	zassert_str_equal(err.fields[5].path, "/f");
}

ZTEST(json_reader, test_pointer_escaping)
{
	EXPECT_FIELDS("{\"name\":\"ab\",\"a/b~c\":1}", {"/a~1b~0c", "unknown_field"});
	/* A name too long for a pointer is reported at its parent. */
	EXPECT_FIELDS("{\"name\":\"ab\",\"inner\":{\"level\":1,"
		      "\"aaaaaaaaaaaaaaaaaaaaaaaaaaaaaaaaaaaaaaaaaaaaaaaaaaaaaaaaaaaaaaaaaaaaaaaa\":1}}",
		      {"/inner", "unknown_field"});
	/* So is one with a control character, which a path may not contain. */
	EXPECT_FIELDS("{\"name\":\"ab\",\"x\\u0001\":1}", {"/", "unknown_field"});
	/* Two such names are one report at the parent, not two. */
	EXPECT_FIELDS("{\"name\":\"ab\",\"x\\u0001\":1,\"y\\u0002\":1}", {"/", "unknown_field"});
	/* A name longer than the decoder keeps is also reported at its parent,
	 * not at an empty segment. */
	EXPECT_FIELDS("{\"name\":\"ab\",\"inner\":{\"level\":1,\"bbbbbbbbbbbbbbbbbbbbbbbbbbbbbbbbbbbbbbbbbbbbbbbbbbbbbbbbbbbbbbbbbbbbbbbbbbbb\":1}}",
		      {"/inner", "unknown_field"});
}

ZTEST(json_reader, test_rejected_value_does_not_stay)
{
	zassert_equal(decode("{\"name\":\"ab\",\"mode\":\"auto\"}"), -EINVAL);
	zassert_equal(d.mode[0], '\0');
}

ZTEST(json_reader, test_reads_only_the_given_length)
{
	const char json[] = "{\"name\":\"ab\"}GARBAGE";

	zassert_ok(web_json_decode(json, 13, &doc_schema, &d, sizeof(d), &err));
}

ZTEST(json_reader, test_code_point_limit_is_checked_where_the_buffer_has_room)
{
	/* A password-like field: the buffer holds 4 bytes per character, so a
	 * value one character too long still fits and only the count refuses it. */
	struct roomy {
		char text[33];
	} v;
	const struct web_json_field fields[] = {
		{.name = "text", .type = WEB_JSON_STRING, .offset = offsetof(struct roomy, text),
		 .size = sizeof(v.text), .max_len = 8},
	};
	const struct web_json_object schema = {fields, 1};
	const char *ok = "{\"text\":\"abcdefgh\"}";
	const char *over = "{\"text\":\"abcdefghi\"}";

	zassert_ok(web_json_decode(ok, strlen(ok), &schema, &v, sizeof(v), &err));
	zassert_equal(web_json_decode(over, strlen(over), &schema, &v, sizeof(v), &err), -EINVAL);
	zassert_str_equal(err.fields[0].path, "/text");
	zassert_equal(err.fields[0].code, API_FIELD_TOO_LONG);
}
```

## src/json_writer.c
```c
/*
 * SPDX-License-Identifier: Apache-2.0
 *
 * The JSON writer: exact output, escaping through api-validation, and every
 * way a document can be malformed or overflow being reported at finish().
 */

#include <string.h>

#include <zephyr/ztest.h>

#include <web_api/json_writer.h>

static char buf[256];
static struct web_json_writer w;

static void before(void *f)
{
	ARG_UNUSED(f);
	memset(buf, 0x55, sizeof(buf));
	web_json_writer_init(&w, buf, sizeof(buf));
}

ZTEST_SUITE(json_writer, NULL, NULL, before, NULL, NULL);

ZTEST(json_writer, test_nested_document)
{
	web_json_object_begin(&w);
	web_json_key(&w, "a");
	web_json_int(&w, -12);
	web_json_key(&w, "b");
	web_json_array_begin(&w);
	web_json_bool(&w, true);
	web_json_null(&w);
	web_json_object_begin(&w);
	web_json_object_end(&w);
	web_json_array_begin(&w);
	web_json_array_end(&w);
	web_json_string(&w, "x");
	web_json_array_end(&w);
	web_json_key(&w, "c");
	web_json_decimal(&w, 18446744073709551615ULL);
	web_json_key(&w, "d");
	web_json_string_or_null(&w, NULL);
	web_json_key(&w, "e");
	web_json_string_or_null(&w, "y");
	web_json_object_end(&w);

	int len = web_json_writer_finish(&w);

	zassert_str_equal(buf, "{\"a\":-12,\"b\":[true,null,{},[],\"x\"],"
			       "\"c\":\"18446744073709551615\",\"d\":null,\"e\":\"y\"}");
	zassert_equal(len, (int)strlen(buf));
}

ZTEST(json_writer, test_extremes)
{
	web_json_array_begin(&w);
	web_json_int(&w, INT64_MIN);
	web_json_int(&w, INT64_MAX);
	web_json_decimal(&w, 0);
	web_json_bool(&w, false);
	web_json_array_end(&w);
	zassert_true(web_json_writer_finish(&w) > 0);
	zassert_str_equal(buf, "[-9223372036854775808,9223372036854775807,\"0\",false]");
}

ZTEST(json_writer, test_text_is_escaped_like_the_error_body)
{
	web_json_string(&w, "q\"b\\n\nr\rt\tc\x01 кириллица");
	zassert_true(web_json_writer_finish(&w) > 0);
	zassert_str_equal(buf, "\"q\\\"b\\\\n\\nr\\rt\\tc\\u0001 кириллица\"");
}

ZTEST(json_writer, test_bare_scalar_document)
{
	web_json_string(&w, "only");
	zassert_true(web_json_writer_finish(&w) > 0);
	zassert_str_equal(buf, "\"only\"");
}

ZTEST(json_writer, test_structural_errors)
{
	/* A second value at the top. */
	web_json_null(&w);
	web_json_null(&w);
	zassert_equal(web_json_writer_finish(&w), -ENOMEM);

	/* A value in an object without a name. */
	web_json_writer_init(&w, buf, sizeof(buf));
	web_json_object_begin(&w);
	web_json_int(&w, 1);
	web_json_object_end(&w);
	zassert_equal(web_json_writer_finish(&w), -ENOMEM);

	/* A name inside an array. */
	web_json_writer_init(&w, buf, sizeof(buf));
	web_json_array_begin(&w);
	web_json_key(&w, "k");
	web_json_array_end(&w);
	zassert_equal(web_json_writer_finish(&w), -ENOMEM);

	/* A name with no value. */
	web_json_writer_init(&w, buf, sizeof(buf));
	web_json_object_begin(&w);
	web_json_key(&w, "k");
	web_json_object_end(&w);
	zassert_equal(web_json_writer_finish(&w), -ENOMEM);

	/* Two names in a row. */
	web_json_writer_init(&w, buf, sizeof(buf));
	web_json_object_begin(&w);
	web_json_key(&w, "k");
	web_json_key(&w, "l");
	zassert_equal(web_json_writer_finish(&w), -ENOMEM);

	/* Unclosed, and mismatched. */
	web_json_writer_init(&w, buf, sizeof(buf));
	web_json_object_begin(&w);
	zassert_equal(web_json_writer_finish(&w), -ENOMEM);
	web_json_writer_init(&w, buf, sizeof(buf));
	web_json_object_begin(&w);
	web_json_array_end(&w);
	zassert_equal(web_json_writer_finish(&w), -ENOMEM);

	/* Closing what was never opened. */
	web_json_writer_init(&w, buf, sizeof(buf));
	web_json_object_end(&w);
	zassert_equal(web_json_writer_finish(&w), -ENOMEM);

	/* Nothing at all. */
	web_json_writer_init(&w, buf, sizeof(buf));
	zassert_equal(web_json_writer_finish(&w), -ENOMEM);

	/* A NULL string. */
	web_json_writer_init(&w, buf, sizeof(buf));
	web_json_string(&w, NULL);
	zassert_equal(web_json_writer_finish(&w), -ENOMEM);
}

ZTEST(json_writer, test_depth_limit)
{
	for (int i = 0; i < WEB_JSON_WRITER_MAX_DEPTH; i++) {
		web_json_array_begin(&w);
	}
	for (int i = 0; i < WEB_JSON_WRITER_MAX_DEPTH; i++) {
		web_json_array_end(&w);
	}
	zassert_true(web_json_writer_finish(&w) > 0, "the limit itself is allowed");

	web_json_writer_init(&w, buf, sizeof(buf));
	for (int i = 0; i <= WEB_JSON_WRITER_MAX_DEPTH; i++) {
		web_json_array_begin(&w);
	}
	zassert_equal(web_json_writer_finish(&w), -ENOMEM);
}

ZTEST(json_writer, test_overflow_is_sticky_and_never_overruns)
{
	char small[12];

	memset(small, 0x55, sizeof(small));
	web_json_writer_init(&w, small, sizeof(small) - 2); /* two guard bytes */
	web_json_array_begin(&w);
	web_json_string(&w, "0123456789");
	web_json_int(&w, 1); /* after the failure: ignored */
	web_json_array_end(&w);
	zassert_equal(web_json_writer_finish(&w), -ENOMEM);
	zassert_equal((uint8_t)small[sizeof(small) - 1], 0x55, "guard byte");
	zassert_equal((uint8_t)small[sizeof(small) - 2], 0x55, "guard byte");

	/* Exactly fitting, including the terminating NUL. */
	web_json_writer_init(&w, small, 5);
	web_json_string(&w, "ab");
	zassert_equal(web_json_writer_finish(&w), 4);
	zassert_str_equal(small, "\"ab\"");

	web_json_writer_init(&w, small, 4);
	web_json_string(&w, "ab");
	zassert_equal(web_json_writer_finish(&w), -ENOMEM, "no room for the NUL");

	web_json_writer_init(&w, NULL, 0);
	web_json_null(&w);
	zassert_equal(web_json_writer_finish(&w), -ENOMEM);
}

ZTEST(json_writer, test_room_and_rollback)
{
	struct web_json_writer saved;

	zassert_equal(web_json_writer_room(&w), sizeof(buf) - 1, "all but the NUL");
	web_json_array_begin(&w);
	zassert_equal(web_json_writer_room(&w), sizeof(buf) - 2);

	saved = w;
	web_json_string(&w, "first");
	zassert_equal(web_json_writer_room(&w), sizeof(buf) - 2 - 7);
	web_json_writer_rollback(&w, &saved);
	zassert_equal(web_json_writer_room(&w), sizeof(buf) - 2);
	zassert_str_equal(buf, "[", "discarded text is gone, terminated where it stood");

	/* A failure after the copy is forgotten with it. */
	char big[300];

	memset(big, 'x', sizeof(big) - 1);
	big[sizeof(big) - 1] = '\0';
	web_json_string(&w, big);
	zassert_equal(web_json_writer_room(&w), 0, "a failed writer has no room");
	web_json_writer_rollback(&w, &saved);
	web_json_string(&w, "ok");
	web_json_array_end(&w);
	zassert_equal(web_json_writer_finish(&w), 6);
	zassert_str_equal(buf, "[\"ok\"]");
	zassert_str_equal(buf, "[\"ok\"]", "no comma from the discarded element");
}
```

## src/v1_coredump.c
```c
/*
 * SPDX-License-Identifier: Apache-2.0
 *
 * The coredump bindings (src/web/api/v1/system.c: getCoredump, downloadCoredump,
 * clearCoredump) through the real route table, over fake hooks: native_sim has
 * no Zephyr coredump, and the board's hooks (src/diagnostic/coredump_support.c)
 * only forward to it. Part of the v1 suite, whose before() resets web-auth;
 * each test here installs the hooks it needs.
 */

#include <errno.h>
#include <stdio.h>
#include <string.h>

#include <zephyr/kernel.h>
#include <zephyr/sys/byteorder.h>
#include <zephyr/ztest.h>

#include "harness.h"
#include "web_api_v1.h"

#define PASSWORD   "correct horse battery"
#define LAN_ORIGIN "http://192.168.88.14"

static char session_cookie[96];
static char csrf[WEB_AUTH_TOKEN_LEN + 1];

/* -- the fake stored dump ------------------------------------------------------------ */

/* Larger than the 16 KiB response buffer, so the download takes several pieces. */
static uint8_t dump[40000];
static int dump_len;
static int size_error;
static int read_error_at = -1;
static int clears;

static int fake_size(void)
{
	return size_error != 0 ? size_error : dump_len;
}

static int fake_read(size_t offset, uint8_t *buf, size_t len)
{
	if (read_error_at >= 0 && offset >= (size_t)read_error_at) {
		return -EIO;
	}
	if (offset >= (size_t)dump_len) {
		return 0;
	}
	len = MIN(len, (size_t)dump_len - offset);
	memcpy(buf, &dump[offset], len);
	return (int)len;
}

static int fake_clear(void)
{
	clears++;
	dump_len = 0;
	return 0;
}

static const struct web_api_v1_coredump hooks = {
	.size = fake_size,
	.read = fake_read,
	.clear = fake_clear,
};

/* A Zephyr coredump header ("ZE", version 2, Cortex-M, 32-bit, reason) and filler. */
static void store_dump(size_t len, uint32_t reason)
{
	for (size_t i = 0; i < len; i++) {
		dump[i] = (uint8_t)(i * 7U + 3U);
	}
	dump[0] = 'Z';
	dump[1] = 'E';
	sys_put_le16(2, &dump[2]);
	sys_put_le16(3, &dump[4]);
	dump[6] = 5;
	dump[7] = 0;
	sys_put_le32(reason, &dump[8]);
	dump_len = (int)len;
}

static void install(void)
{
	dump_len = 0;
	size_error = 0;
	read_error_at = -1;
	clears = 0;
	web_api_v1_set_coredump(&hooks);
}

/* -- requests -------------------------------------------------------------------------- */

static bool json_string(const char *text, const char *name, char *out, size_t cap)
{
	char key[48];
	const char *p;
	const char *end;

	snprintf(key, sizeof(key), "\"%s\":\"", name);
	p = strstr(text, key);
	if (p == NULL) {
		return false;
	}
	p += strlen(key);
	end = strchr(p, '"');
	if (end == NULL || (size_t)(end - p) >= cap) {
		return false;
	}
	memcpy(out, p, end - p);
	out[end - p] = '\0';
	return true;
}

static void sign_in(void)
{
	char token[WEB_AUTH_SETUP_TOKEN_LEN + 1];
	const char *set_cookie;
	const char *semi;

	request(WEB_API_GET, "/api/v1/auth/state");
	dispatch(&web_api_v1_router);
	zassert_true(json_string(body, "setup_token", token, sizeof(token)));
	request(WEB_API_POST, "/api/v1/auth/setup");
	ctx.req.headers.origin = LAN_ORIGIN;
	ctx.req.headers.setup_token = token;
	request_body("{\"password\":\"" PASSWORD "\"}");
	dispatch(&web_api_v1_router);
	zassert_equal(ctx.rsp.status, 201, "%s", body);
	zassert_true(json_string(body, "csrf_token", csrf, sizeof(csrf)));
	set_cookie = response_header("Set-Cookie");
	semi = strchr(set_cookie, ';');
	memcpy(session_cookie, set_cookie, semi - set_cookie);
	session_cookie[semi - set_cookie] = '\0';
}

static void get(const char *path)
{
	request(WEB_API_GET, path);
	ctx.req.headers.cookie = session_cookie;
	dispatch(&web_api_v1_router);
}

static void clear(bool with_csrf)
{
	request(WEB_API_DELETE, "/api/v1/system/coredump");
	ctx.req.headers.cookie = session_cookie;
	ctx.req.headers.origin = LAN_ORIGIN;
	if (with_csrf) {
		ctx.req.headers.csrf_token = csrf;
	}
	dispatch(&web_api_v1_router);
}

static void expect_error(uint16_t status, const char *code)
{
	char fragment[64];

	snprintf(fragment, sizeof(fragment), "\"code\":\"%s\"", code);
	zassert_equal(ctx.rsp.status, status, "%s", body);
	zassert_true(body_has(fragment), "%s", body);
}

static uint8_t downloaded[sizeof(dump)];

/* Pull every piece of the stream the last dispatch started; the bytes, or -1 on an error. */
static int pull_all(int *pieces)
{
	size_t n = 0;
	bool final = false;

	*pieces = 0;
	for (int guard = 0; !final && guard < 100; guard++) {
		if (web_api_stream_pull(&ctx, &final) != 0) {
			return -1;
		}
		zassert_true(n + ctx.rsp.body_len <= sizeof(downloaded));
		memcpy(&downloaded[n], ctx.rsp.body, ctx.rsp.body_len);
		n += ctx.rsp.body_len;
		*pieces += ctx.rsp.body_len > 0 ? 1 : 0;
	}
	zassert_true(final);
	zassert_false(web_api_stream_active(&ctx));
	return (int)n;
}

/* -- tests ------------------------------------------------------------------------------- */

ZTEST(v1, test_coredump_without_hooks_is_unavailable)
{
	sign_in();
	web_api_v1_set_coredump(NULL);

	get("/api/v1/system/coredump");
	expect_error(503, "capability_unavailable");
	get("/api/v1/system/coredump/data");
	expect_error(503, "capability_unavailable");
	clear(true);
	expect_error(503, "capability_unavailable");
}

ZTEST(v1, test_coredump_needs_a_session)
{
	install();
	request(WEB_API_GET, "/api/v1/system/coredump");
	dispatch(&web_api_v1_router);
	expect_error(401, "authentication_required");
	request(WEB_API_GET, "/api/v1/system/coredump/data");
	dispatch(&web_api_v1_router);
	expect_error(401, "authentication_required");
}

ZTEST(v1, test_coredump_none_stored)
{
	sign_in();
	install();

	get("/api/v1/system/coredump");
	zassert_equal(ctx.rsp.status, 200, "%s", body);
	zassert_str_equal(body, "{\"coredump\":null}");
	get("/api/v1/system/coredump/data");
	expect_error(404, "not_found");
}

ZTEST(v1, test_coredump_describes_the_stored_dump)
{
	sign_in();
	install();
	store_dump(30000, 4);

	get("/api/v1/system/coredump");
	zassert_equal(ctx.rsp.status, 200, "%s", body);
	zassert_str_equal(body, "{\"coredump\":{\"size_bytes\":30000,\"reason\":\"kernel_panic\","
				"\"reason_code\":4}}");

	/* Architecture codes are CPU exceptions. */
	store_dump(100, 17);
	get("/api/v1/system/coredump");
	zassert_true(body_has("\"reason\":\"cpu_exception\",\"reason_code\":17"), "%s", body);
}

ZTEST(v1, test_coredump_without_its_header_has_no_reason)
{
	sign_in();
	install();
	store_dump(100, 0);
	dump[0] = 'X';

	get("/api/v1/system/coredump");
	zassert_equal(ctx.rsp.status, 200, "%s", body);
	zassert_str_equal(body, "{\"coredump\":{\"size_bytes\":100,\"reason\":null,"
				"\"reason_code\":null}}");
}

ZTEST(v1, test_coredump_downloads_every_byte_in_pieces)
{
	int pieces;
	int n;

	sign_in();
	install();
	store_dump(sizeof(dump), 0);

	get("/api/v1/system/coredump/data");
	zassert_equal(ctx.rsp.status, 200, "%s", body);
	zassert_str_equal(response_header("Content-Type"), "application/octet-stream");
	zassert_str_equal(response_header("Content-Disposition"),
			  "attachment; filename=\"cedar-coredump.bin\"");
	zassert_true(web_api_stream_active(&ctx));
	n = pull_all(&pieces);
	zassert_equal(n, (int)sizeof(dump));
	zassert_true(pieces > 1, "%d pieces", pieces);
	zassert_mem_equal(downloaded, dump, sizeof(dump));
}

ZTEST(v1, test_coredump_read_failure_cuts_the_download)
{
	int pieces;

	sign_in();
	install();
	store_dump(sizeof(dump), 0);
	read_error_at = 20000;

	get("/api/v1/system/coredump/data");
	zassert_equal(ctx.rsp.status, 200, "%s", body);
	zassert_equal(pull_all(&pieces), -1, "an incomplete file must not look complete");
}

ZTEST(v1, test_coredump_unreadable_storage_is_an_internal_error)
{
	sign_in();
	install();
	size_error = -EIO;

	get("/api/v1/system/coredump");
	expect_error(500, "internal_error");
	get("/api/v1/system/coredump/data");
	expect_error(500, "internal_error");
}

ZTEST(v1, test_coredump_clear)
{
	sign_in();
	install();
	store_dump(100, 3);

	clear(false);
	expect_error(403, "csrf_failed");
	zassert_equal(clears, 0);

	clear(true);
	zassert_equal(ctx.rsp.status, 204, "%s", body);
	zassert_equal(clears, 1);
	get("/api/v1/system/coredump");
	zassert_str_equal(body, "{\"coredump\":null}");

	/* Nothing stored: still 204. */
	clear(true);
	zassert_equal(ctx.rsp.status, 204, "%s", body);
}
```
