## CMakeLists.txt
```
cmake_minimum_required(VERSION 3.20.0)

# network-manager sits on top of the other three, so all four are registered
# the same way the application does it, before find_package(Zephyr).
list(APPEND ZEPHYR_EXTRA_MODULES
    ${CMAKE_CURRENT_SOURCE_DIR}/../../modules/api-validation
    ${CMAKE_CURRENT_SOURCE_DIR}/../../modules/job-manager
    ${CMAKE_CURRENT_SOURCE_DIR}/../../modules/device-config-store
    ${CMAKE_CURRENT_SOURCE_DIR}/../../modules/network-manager
)

find_package(Zephyr REQUIRED HINTS $ENV{ZEPHYR_BASE})
project(network_manager_test)

# Both fakes are shared: the web API suite drives the network bindings over the
# same interface fake.
target_include_directories(app PRIVATE ${CMAKE_CURRENT_SOURCE_DIR}/../fakes)
target_sources(app PRIVATE
    src/main.c
    ../fakes/fake_iface.c
    ../fakes/fake_storage.c
)
```

## prj.conf
```kconfig
CONFIG_ZTEST=y
CONFIG_NETWORK_MANAGER=y

# Selected by NETWORK_MANAGER, listed here so the dependency is visible to
# anyone reading the test configuration.
CONFIG_DEVICE_CONFIG_STORE=y
CONFIG_JOB_MANAGER=y
CONFIG_API_VALIDATION=y

CONFIG_LOG=y
CONFIG_NETWORK_MANAGER_LOG_LEVEL=2
CONFIG_DEVICE_CONFIG_STORE_LOG_LEVEL=1

# Production values. The deadlines are driven by an injected clock, so keeping
# the real numbers costs nothing and means the tests assert on the timings the
# contract actually specifies.
CONFIG_NETWORK_MANAGER_CANDIDATE_TTL_SECONDS=300
CONFIG_NETWORK_MANAGER_CONFIRM_TIMEOUT_SECONDS=120
CONFIG_NETWORK_MANAGER_CONFIRM_TIMEOUT_MIN_SECONDS=60
CONFIG_NETWORK_MANAGER_CONFIRM_TIMEOUT_MAX_SECONDS=300
CONFIG_NETWORK_MANAGER_SCAN_MAX_RESULTS=64
```

## src/fake_iface.c
```c
/*
 * SPDX-License-Identifier: Apache-2.0
 *
 * See fake_iface.h.
 */

#include <errno.h>
#include <string.h>

#include <zephyr/sys/util.h>

#include "fake_iface.h"

/*
 * Derive what an interface would actually end up with, given what it was told
 * and what the test says the segment is doing. This is the part that makes the
 * health check worth testing: a static address appears immediately, a DHCP one
 * only if a server answers, and neither appears at all with the link down.
 */
static void settle(struct fake_iface *fi)
{
	fi->has_ipv4 = false;
	fi->has_route = false;
	fi->prefix_length = 0;
	memset(fi->ipv4, 0, sizeof(fi->ipv4));

	if (!fi->present || !fi->configured || !fi->enabled || !fi->link_up) {
		return;
	}

	if (fi->applied.mode == DEVICE_CONFIG_IPV4_STATIC) {
		memcpy(fi->ipv4, fi->applied.address, sizeof(fi->ipv4));
		fi->prefix_length = fi->applied.prefix_length;
		fi->has_ipv4 = true;
		fi->has_route = fi->applied.has_gateway && !fi->suppress_route;
		return;
	}

	if (fi->dhcp_answers) {
		/* A lease from the segment the board actually lives on. */
		fi->ipv4[0] = 192;
		fi->ipv4[1] = 168;
		fi->ipv4[2] = 88;
		fi->ipv4[3] = 14;
		fi->prefix_length = 24;
		fi->has_ipv4 = true;
		fi->has_route = !fi->suppress_route;
	}
}

static struct fake_iface *pick(struct fake_net *fn, enum device_config_interface iface)
{
	return (iface == DEVICE_CONFIG_INTERFACE_ETHERNET) ? &fn->eth : &fn->wifi;
}

static int fake_configure(void *ctx, enum device_config_interface iface,
			  const struct device_config_ipv4 *ipv4, bool enabled)
{
	struct fake_net *fn = ctx;

	if (fn->fail_configure != 0) {
		int err = fn->fail_configure;

		fn->fail_configure = 0;
		return err;
	}

	struct fake_iface *fi = pick(fn, iface);

	fi->configure_calls++;
	fi->configured = true;
	fi->enabled = enabled;
	fi->applied = *ipv4;
	settle(fi);

	return 0;
}

static int fake_wifi_connect(void *ctx, const uint8_t *ssid, size_t ssid_len,
			     enum device_config_wifi_security security, bool hidden,
			     const uint8_t *password, size_t password_len)
{
	struct fake_net *fn = ctx;

	ARG_UNUSED(security);
	ARG_UNUSED(hidden);

	fn->connect_calls++;

	if (fn->fail_connect != 0) {
		int err = fn->fail_connect;

		fn->fail_connect = 0;
		return err;
	}
	if (!fn->wifi.present) {
		return -ENODEV;
	}

	fn->associated = fn->wifi.wifi_associates;
	fn->ssid_len = (uint8_t)MIN(ssid_len, sizeof(fn->ssid));
	memcpy(fn->ssid, ssid, fn->ssid_len);

	fn->password_len = MIN(password_len, sizeof(fn->password));
	memset(fn->password, 0, sizeof(fn->password));
	if (password != NULL) {
		memcpy(fn->password, password, fn->password_len);
	}

	/*
	 * Association is what brings the radio's link up, which is why a wrong
	 * password shows as an interface that was configured and still has no
	 * address rather than as a failed call.
	 */
	fn->wifi.link_up = fn->associated;
	settle(&fn->wifi);

	return 0;
}

static int fake_wifi_disconnect(void *ctx)
{
	struct fake_net *fn = ctx;

	fn->disconnect_calls++;
	fn->associated = false;
	fn->ssid_len = 0;
	fn->wifi.link_up = false;
	settle(&fn->wifi);

	return 0;
}

static int fake_get_status(void *ctx, enum device_config_interface iface,
			   struct network_iface_status *out)
{
	struct fake_net *fn = ctx;
	struct fake_iface *fi = pick(fn, iface);

	settle(fi);
	memset(out, 0, sizeof(*out));

	out->present = fi->present;
	out->enabled = fi->enabled;
	out->link_up = fi->present && fi->link_up;
	out->has_ipv4 = fi->has_ipv4;
	memcpy(out->ipv4, fi->ipv4, sizeof(out->ipv4));
	out->prefix_length = fi->prefix_length;
	out->has_gateway = fi->applied.has_gateway;
	memcpy(out->gateway, fi->applied.gateway, sizeof(out->gateway));
	out->has_route = fi->has_route;

	if (iface == DEVICE_CONFIG_INTERFACE_WIFI) {
		out->wifi_associated = fn->associated;
		out->ssid_len = fn->ssid_len;
		memcpy(out->ssid, fn->ssid, fn->ssid_len);
		out->rssi = -55;
		out->rssi_valid = fn->associated;
	}

	return 0;
}

static int fake_set_dns(void *ctx, const struct device_config_addr *servers, size_t count)
{
	struct fake_net *fn = ctx;

	fn->set_dns_calls++;
	fn->dns_count = (uint8_t)MIN(count, (size_t)DEVICE_CONFIG_DNS_MAX_SERVERS);
	memset(fn->dns, 0, sizeof(fn->dns));
	if (servers != NULL && fn->dns_count > 0U) {
		memcpy(fn->dns, servers, sizeof(fn->dns[0]) * fn->dns_count);
	}

	return 0;
}

static int fake_wifi_scan(void *ctx, struct network_scan_results *out)
{
	struct fake_net *fn = ctx;

	fn->scan_calls++;

	if (fn->fail_scan != 0) {
		int err = fn->fail_scan;

		fn->fail_scan = 0;
		return err;
	}

	*out = fn->scan_results;

	return 0;
}

void fake_net_init(struct fake_net *fn)
{
	memset(fn, 0, sizeof(*fn));

	/* A plausible board: cable in, DHCP working, C6 fitted but idle. */
	fn->eth.present = true;
	fn->eth.link_up = true;
	fn->eth.dhcp_answers = true;

	fn->wifi.present = true;
	fn->wifi.link_up = false;
	fn->wifi.dhcp_answers = true;
	fn->wifi.wifi_associates = true;
}

void fake_net_bind(struct fake_net *fn, struct network_iface_ops *ops)
{
	memset(ops, 0, sizeof(*ops));

	ops->configure = fake_configure;
	ops->wifi_connect = fake_wifi_connect;
	ops->wifi_disconnect = fake_wifi_disconnect;
	ops->get_status = fake_get_status;
	ops->set_dns = fake_set_dns;
	ops->wifi_scan = fn->no_radio ? NULL : fake_wifi_scan;
	ops->ctx = fn;
}
```

## src/fake_iface.h
```c
/*
 * SPDX-License-Identifier: Apache-2.0
 *
 * A network interface adapter that can be told what the world looks like.
 *
 * The transaction this module implements is entirely about what happens when
 * the network does *not* come up — a Wi-Fi password that does not work, a
 * cable that is out, DHCP that never answers. None of that can be produced on
 * demand against real hardware, so the sim tier drives it here: each
 * interface's link, address and route are set by the test, and configure()
 * and wifi_connect() can be made to fail.
 *
 * The fake also models the one behaviour that makes the health check
 * meaningful: applying a configuration does not by itself give an interface an
 * address. A DHCP interface gets one only if the test says the server answers,
 * which is how "applied but not working yet" is reached.
 */

#ifndef FAKE_IFACE_H_
#define FAKE_IFACE_H_

#include <stdbool.h>
#include <stdint.h>

#include <network_manager/network_manager.h>

struct fake_iface {
	/* What the test says the physical world is doing. */
	bool present;
	bool link_up;
	/** A DHCP server answers on this segment. */
	bool dhcp_answers;
	/** wifi_connect() succeeds, i.e. the password and SSID are right. */
	bool wifi_associates;
	/**
	 * Withhold the default route while keeping link and address. A gateway
	 * that is configured but does not answer looks exactly like this, and
	 * it is the case that separates a working subnet from a device with no
	 * way off it.
	 */
	bool suppress_route;

	/* What the adapter has been told to do. */
	bool configured;
	bool enabled;
	struct device_config_ipv4 applied;
	unsigned int configure_calls;

	/* Resulting runtime state, derived at get_status() time. */
	bool has_ipv4;
	uint8_t ipv4[4];
	uint8_t prefix_length;
	bool has_route;
};

struct fake_net {
	struct fake_iface eth;
	struct fake_iface wifi;

	/* Wi-Fi association. */
	bool associated;
	uint8_t ssid[DEVICE_CONFIG_SSID_MAX_LEN];
	uint8_t ssid_len;
	uint8_t password[DEVICE_CONFIG_SECRET_MAX_LEN];
	size_t password_len;
	unsigned int connect_calls;
	unsigned int disconnect_calls;

	/* DNS. */
	struct device_config_addr dns[DEVICE_CONFIG_DNS_MAX_SERVERS];
	uint8_t dns_count;
	unsigned int set_dns_calls;

	/* Injection. */
	int fail_configure;  /**< errno returned by the next configure(), or 0. */
	int fail_connect;    /**< errno returned by the next wifi_connect(), or 0. */
	int fail_scan;       /**< errno returned by the next wifi_scan(), or 0. */
	bool no_radio;       /**< Present the ops table without wifi_scan. */

	/* Scan. */
	struct network_scan_results scan_results;
	unsigned int scan_calls;
};

/** Reset to a plausible healthy board: Ethernet up with DHCP, Wi-Fi present. */
void fake_net_init(struct fake_net *fn);

/** Fill @p ops with callbacks bound to @p fn. */
void fake_net_bind(struct fake_net *fn, struct network_iface_ops *ops);

#endif /* FAKE_IFACE_H_ */
```
