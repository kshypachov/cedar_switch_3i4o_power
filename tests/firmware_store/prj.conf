## CMakeLists.txt
```
cmake_minimum_required(VERSION 3.20.0)

# The module under test is not in the west manifest, so register it the same
# way the application does, before find_package(Zephyr).
list(APPEND ZEPHYR_EXTRA_MODULES
    ${CMAKE_CURRENT_SOURCE_DIR}/../../modules/firmware-store
)

find_package(Zephyr REQUIRED HINTS $ENV{ZEPHYR_BASE})
project(firmware_store_test)

target_sources(app PRIVATE
    src/main.c
    src/md5.c
    src/image.c
    src/store.c
)

# The synthetic corpus (tests/fixtures/esp32/firmware, gen_firmware_fixtures.py)
# as byte arrays: fw_<name>.inc.
set(FIXTURES ${CMAKE_CURRENT_SOURCE_DIR}/../fixtures/esp32/firmware)
set(GEN_DIR ${ZEPHYR_BINARY_DIR}/include/generated)
foreach(name
    valid valid_16_segments truncated bootloader_wrong_chip app_wrong_chip bare_app other_layout
    bad_table_md5 bad_app_sha junk_in_nvs no_app_desc no_bootloader_desc)
  generate_inc_file_for_target(app ${FIXTURES}/${name}.bin ${GEN_DIR}/fw_${name}.inc)
endforeach()
```

## prj.conf
```kconfig
CONFIG_ZTEST=y
CONFIG_ZTEST_STACK_SIZE=32768
CONFIG_MAIN_STACK_SIZE=8192

# LittleFS on the sim flash, in a 1 MiB partition of its own (boards/*.overlay):
# large enough for the corpus, too small for a 0x1d0000 upload - which is the
# storage_full case.
CONFIG_FLASH=y
CONFIG_FLASH_MAP=y
CONFIG_FILE_SYSTEM=y
CONFIG_FILE_SYSTEM_LITTLEFS=y
CONFIG_FS_LITTLEFS_NUM_FILES=8

# SHA-256 through PSA, as on the device (zephyr/tests/crypto/psa).
CONFIG_PSA_CRYPTO=y
CONFIG_MBEDTLS_PSA_STATIC_KEY_SLOTS=y
CONFIG_PSA_WANT_ALG_SHA_256=y

CONFIG_FIRMWARE_STORE=y
# Not a multiple of the volume's 4 KiB allocation unit, so rounding the image up
# to whole units is observable (test_storage_full_at_create).
CONFIG_FIRMWARE_STORE_RESERVE_KIB=34
```

## boards/native_sim.overlay
```dts
/*
 * The sim flash doubled to 4 MiB, with a 1 MiB partition for the store's
 * LittleFS volume above everything native_sim already defines.
 */

&flashcontroller0 {
	reg = <0x00000000 DT_SIZE_K(4096)>;
};

&flash0 {
	reg = <0x00000000 DT_SIZE_K(4096)>;
	ranges = <0x0 0x0 DT_SIZE_K(4096)>;

	partitions {
		fw_test_partition: partition@200000 {
			compatible = "zephyr,mapped-partition";
			label = "fw_test";
			reg = <0x00200000 0x00100000>;
		};
	};
};
```

## src/main.c
```c
/*
 * SPDX-License-Identifier: Apache-2.0
 *
 * firmware-store tests: the corpus as byte arrays, the test volume, SHA-256.
 * The suites are in md5.c, image.c and store.c.
 */

#include <string.h>

#include <zephyr/fs/fs.h>
#include <zephyr/fs/littlefs.h>
#include <zephyr/storage/flash_map.h>
#include <zephyr/ztest.h>

#include <psa/crypto.h>

#include "common.h"

static const uint8_t fx_valid[] = {
#include "fw_valid.inc"
};
static const uint8_t fx_valid_16_segments[] = {
#include "fw_valid_16_segments.inc"
};
static const uint8_t fx_truncated[] = {
#include "fw_truncated.inc"
};
static const uint8_t fx_bootloader_wrong_chip[] = {
#include "fw_bootloader_wrong_chip.inc"
};
static const uint8_t fx_app_wrong_chip[] = {
#include "fw_app_wrong_chip.inc"
};
static const uint8_t fx_bare_app[] = {
#include "fw_bare_app.inc"
};
static const uint8_t fx_other_layout[] = {
#include "fw_other_layout.inc"
};
static const uint8_t fx_bad_table_md5[] = {
#include "fw_bad_table_md5.inc"
};
static const uint8_t fx_bad_app_sha[] = {
#include "fw_bad_app_sha.inc"
};
static const uint8_t fx_junk_in_nvs[] = {
#include "fw_junk_in_nvs.inc"
};
static const uint8_t fx_no_app_desc[] = {
#include "fw_no_app_desc.inc"
};
static const uint8_t fx_no_bootloader_desc[] = {
#include "fw_no_bootloader_desc.inc"
};

#define FX(n, c, m) {#n, fx_##n, sizeof(fx_##n), c, m}

/* The same outcomes as tests/fixtures/esp32/firmware/manifest.json. */
const struct fixture corpus[] = {
	FX(valid, NULL, NULL),
	FX(valid_16_segments, NULL, NULL),
	FX(truncated, "invalid_image", "application segment runs past the end of the file"),
	FX(bootloader_wrong_chip, "unsupported_target", "The bootloader is built for another chip"),
	FX(app_wrong_chip, "unsupported_target", "The application is built for another chip"),
	FX(bare_app, "invalid_image", "This is an application image"),
	FX(other_layout, "incompatible_firmware", "layout is not one this device supports"),
	FX(bad_table_md5, "invalid_image", "MD5 record does not match"),
	FX(bad_app_sha, "invalid_image", "The application's SHA-256 does not match"),
	FX(junk_in_nvs, "invalid_image", "NVS, otadata and phy_init"),
	FX(no_app_desc, "invalid_image", "has no application description"),
	FX(no_bootloader_desc, "invalid_image", "has no bootloader description"),
};
const size_t corpus_count = ARRAY_SIZE(corpus);

const struct fixture *fixture(const char *name)
{
	for (size_t i = 0; i < corpus_count; i++) {
		if (strcmp(corpus[i].name, name) == 0) {
			return &corpus[i];
		}
	}
	zassert_unreachable("no fixture %s", name);
	return NULL;
}

FS_LITTLEFS_DECLARE_DEFAULT_CONFIG(test_lfs);

static struct fs_mount_t mnt = {
	.type = FS_LITTLEFS,
	.fs_data = &test_lfs,
	.storage_dev = (void *)PARTITION_ID(fw_test_partition),
	.mnt_point = TEST_MNT,
};
static bool mounted;

void volume_fresh(void)
{
	const struct flash_area *fa;

	if (mounted) {
		zassert_ok(fs_unmount(&mnt));
		mounted = false;
	}
	zassert_ok(flash_area_open(PARTITION_ID(fw_test_partition), &fa));
	zassert_ok(flash_area_erase(fa, 0, fa->fa_size));
	flash_area_close(fa);
	zassert_ok(fs_mount(&mnt));
	mounted = true;
}

void volume_remount(void)
{
	zassert_ok(fs_unmount(&mnt));
	zassert_ok(fs_mount(&mnt));
}

void sha256_of(const uint8_t *data, size_t len, uint8_t out[32])
{
	size_t n = 0;

	zassert_equal(psa_crypto_init(), PSA_SUCCESS);
	zassert_equal(psa_hash_compute(PSA_ALG_SHA_256, data, len, out, 32, &n), PSA_SUCCESS);
	zassert_equal(n, 32U);
}
```

## src/common.h
```c
/*
 * SPDX-License-Identifier: Apache-2.0
 *
 * Shared by the firmware-store suites: the synthetic corpus and the test volume.
 */

#ifndef FIRMWARE_STORE_TEST_COMMON_H_
#define FIRMWARE_STORE_TEST_COMMON_H_

#include <stddef.h>
#include <stdint.h>

#define TEST_MNT "/fw"
#define TEST_DIR "/fw/firmware"

/* One file of tests/fixtures/esp32/firmware and what the device must say about it. */
struct fixture {
	const char *name;
	const uint8_t *data;
	size_t len;
	/* NULL when the file is valid. */
	const char *code;
	/* A fragment of the expected message; NULL when valid. */
	const char *message;
};

extern const struct fixture corpus[];
extern const size_t corpus_count;

const struct fixture *fixture(const char *name);

/* Erase the test partition and mount an empty LittleFS volume on it. */
void volume_fresh(void);
/* Unmount and mount again, keeping the contents: a reboot of the store. */
void volume_remount(void);

void sha256_of(const uint8_t *data, size_t len, uint8_t out[32]);

#endif
```

## src/image.c
```c
/*
 * SPDX-License-Identifier: Apache-2.0
 *
 * fw_image: the full-flash check on the corpus, fed in pieces of every size, and
 * on single-byte faults placed where each rule looks.
 */

#include <string.h>

#include <zephyr/sys/byteorder.h>
#include <zephyr/ztest.h>

#include <firmware_store/fw_image.h>
#include <firmware_store/fw_md5.h>

#include "common.h"

static struct fw_image_check check;
static uint8_t work[0x11000];

static enum fw_image_result run(const uint8_t *data, size_t len, uint32_t declared, size_t piece,
				struct fw_image_info *info, const char **message)
{
	fw_image_check_begin(&check, declared);
	for (size_t off = 0; off < len; off += piece) {
		fw_image_check_feed(&check, &data[off], MIN(piece, len - off));
	}
	return fw_image_check_end(&check, info, message);
}

static enum fw_image_result run_whole(const uint8_t *data, size_t len, const char **message)
{
	struct fw_image_info info;

	return run(data, len, (uint32_t)len, len, &info, message);
}

static void assert_message(const char *message, const char *fragment)
{
	zassert_not_null(message);
	zassert_not_null(strstr(message, fragment), "\"%s\" lacks \"%s\"", message, fragment);
}

/* A copy of the valid file to damage. */
static const uint8_t *valid_copy(size_t *len)
{
	const struct fixture *f = fixture("valid");

	zassert_true(f->len <= sizeof(work));
	memcpy(work, f->data, f->len);
	*len = f->len;
	return work;
}

static void expect_fault(size_t len, const char *code, const char *fragment)
{
	const char *message = NULL;
	enum fw_image_result r = run_whole(work, len, &message);

	zassert_str_equal(fw_image_result_code(r) ? fw_image_result_code(r) : "ok", code);
	assert_message(message, fragment);
}

ZTEST(fw_image, test_corpus_outcomes)
{
	for (size_t i = 0; i < corpus_count; i++) {
		const struct fixture *f = &corpus[i];
		const char *message = NULL;
		enum fw_image_result r = run_whole(f->data, f->len, &message);

		if (f->code == NULL) {
			zassert_equal(r, FW_IMAGE_OK, "%s: %s", f->name, message ? message : "");
			zassert_is_null(message);
		} else {
			zassert_not_null(fw_image_result_code(r), "%s accepted", f->name);
			zassert_str_equal(fw_image_result_code(r), f->code, "%s", f->name);
			assert_message(message, f->message);
		}
	}
}

ZTEST(fw_image, test_outcome_does_not_depend_on_piece_size)
{
	static const size_t pieces[] = {1, 3, 31, 32, 4096, 16384, 0x8001};

	for (size_t i = 0; i < corpus_count; i++) {
		const struct fixture *f = &corpus[i];
		const char *whole_message = NULL;
		const enum fw_image_result whole = run_whole(f->data, f->len, &whole_message);

		for (size_t p = 0; p < ARRAY_SIZE(pieces); p++) {
			struct fw_image_info info;
			const char *message = NULL;
			enum fw_image_result r =
				run(f->data, f->len, (uint32_t)f->len, pieces[p], &info, &message);

			zassert_equal(r, whole, "%s in pieces of %zu", f->name, pieces[p]);
			zassert_equal(message, whole_message, "%s in pieces of %zu", f->name, pieces[p]);
		}
	}
}

ZTEST(fw_image, test_valid_file_describes_itself)
{
	const struct fixture *f = fixture("valid");
	struct fw_image_info info;
	const char *message = NULL;
	uint8_t digest[32];

	zassert_equal(run(f->data, f->len, (uint32_t)f->len, 4096, &info, &message), FW_IMAGE_OK);
	zassert_str_equal(info.version, "1.2.3-synthetic");
	zassert_str_equal(info.project_name, "eh_cp_c6_cedar");
	zassert_str_equal(info.idf_version, "v5.5.5-synthetic");
	zassert_str_equal(info.layout_id, "cedar-c6-ota-4m-2x1792k");
	zassert_str_equal(info.host_protocol, "esp-hosted-mcu-3");
	/* Header 24 + two segment headers + 180 + 77 data, padded to 16, + digest. */
	zassert_equal(info.bootloader_bytes, 336U);
	zassert_equal(info.app_bytes, (uint32_t)f->len - FW_IMAGE_APP_OFFSET);
	sha256_of(f->data, f->len, digest);
	zassert_mem_equal(info.sha256, digest, sizeof(digest));
}

ZTEST(fw_image, test_incompatible_layout_keeps_the_description)
{
	const struct fixture *f = fixture("other_layout");
	struct fw_image_info info;
	const char *message = NULL;

	zassert_equal(run(f->data, f->len, (uint32_t)f->len, f->len, &info, &message),
		      FW_IMAGE_INCOMPATIBLE);
	zassert_is_null(info.layout_id);
	zassert_is_null(info.host_protocol);
	zassert_str_equal(info.version, "1.2.3-synthetic");
}

ZTEST(fw_image, test_sizes_that_cannot_be_images)
{
	const struct fixture *f = fixture("valid");
	struct fw_image_info info;
	const char *message = NULL;

	/* Declared past ota_1: refused whatever the bytes are. */
	zassert_equal(run(f->data, f->len, FW_IMAGE_MAX_BYTES + 1U, f->len, &info, &message),
		      FW_IMAGE_INVALID);
	assert_message(message, "reaches ota_1");

	/* Exactly the region before the application, nothing after. */
	zassert_equal(run(f->data, FW_IMAGE_APP_OFFSET, FW_IMAGE_APP_OFFSET, 4096, &info,
			  &message),
		      FW_IMAGE_INVALID);
	assert_message(message, "ends before the application");

	/* Fed less than declared. */
	zassert_equal(run(f->data, f->len - 10U, (uint32_t)f->len, 4096, &info, &message),
		      FW_IMAGE_INVALID);
	assert_message(message, "shorter than its declared size");
	zassert_equal(info.app_bytes, 0U);
}

ZTEST(fw_image, test_bytes_past_the_declared_size_are_ignored)
{
	const struct fixture *f = fixture("valid");
	struct fw_image_info info;
	const char *message = NULL;

	fw_image_check_begin(&check, (uint32_t)f->len);
	fw_image_check_feed(&check, f->data, f->len);
	fw_image_check_feed(&check, f->data, 100);
	zassert_equal(fw_image_check_end(&check, &info, &message), FW_IMAGE_OK);
}

ZTEST(fw_image, test_trailing_byte_after_the_application)
{
	size_t len;

	valid_copy(&len);
	work[len] = 0xFF;
	expect_fault(len + 1U, "invalid_image", "Bytes follow the end of the application");
}

ZTEST(fw_image, test_bootloader_faults)
{
	size_t len;

	valid_copy(&len);
	work[0] = 0x00;
	expect_fault(len, "invalid_image", "No ESP image header at 0x0");

	valid_copy(&len);
	work[1] = 0;
	expect_fault(len, "invalid_image", "impossible segment count");

	valid_copy(&len);
	work[1] = 17;
	expect_fault(len, "invalid_image", "impossible segment count");

	valid_copy(&len);
	work[23] = 0;
	expect_fault(len, "invalid_image", "no appended SHA-256");

	/* A byte of segment data: the checksum sees it before the digest does. */
	valid_copy(&len);
	work[0x100] ^= 0x01;
	expect_fault(len, "invalid_image", "bootloader's checksum does not match");

	/* The checksum byte itself: 336 - 33. */
	valid_copy(&len);
	work[303] ^= 0x01;
	expect_fault(len, "invalid_image", "bootloader's checksum does not match");

	/* The digest. */
	valid_copy(&len);
	work[335] ^= 0x80;
	expect_fault(len, "invalid_image", "bootloader's SHA-256 does not match");

	/* The first byte after the bootloader. */
	valid_copy(&len);
	work[336] = 0x00;
	expect_fault(len, "invalid_image", "between the bootloader and the partition table");

	/* The last byte of the bootloader's region. */
	valid_copy(&len);
	work[FW_IMAGE_TABLE_OFFSET - 1U] = 0x7F;
	expect_fault(len, "invalid_image", "between the bootloader and the partition table");
}

ZTEST(fw_image, test_bootloader_segment_past_its_region)
{
	size_t len;

	/* The second segment's length reaching past 0x8000. */
	valid_copy(&len);
	sys_put_le32(0x8000, &work[24 + 8 + 180 + 4]);
	expect_fault(len, "invalid_image", "bootloader segment runs past 0x8000");

	/* The first segment's length reaching past 0x8000: runs into the table. */
	valid_copy(&len);
	sys_put_le32(0x9000, &work[24 + 4]);
	expect_fault(len, "invalid_image", "The bootloader runs past 0x8000");

	/* A length no image can have. */
	valid_copy(&len);
	sys_put_le32(0xFFFFFFFF, &work[24 + 4]);
	expect_fault(len, "invalid_image", "bootloader segment runs past 0x8000");

	/* The first segment too short for the description. */
	valid_copy(&len);
	sys_put_le32(79, &work[24 + 4]);
	expect_fault(len, "invalid_image", "too short to hold the image description");
}

ZTEST(fw_image, test_partition_table_faults)
{
	const size_t md5_record = FW_IMAGE_TABLE_OFFSET + 5U * 32U;
	size_t len;

	/* No table at all. */
	valid_copy(&len);
	memset(&work[FW_IMAGE_TABLE_OFFSET], 0xFF, md5_record + 32U - FW_IMAGE_TABLE_OFFSET);
	expect_fault(len, "invalid_image", "No partition table at 0x8000");

	/* Garbage where the table starts. */
	valid_copy(&len);
	work[FW_IMAGE_TABLE_OFFSET] = 0x00;
	expect_fault(len, "invalid_image", "No partition table at 0x8000");

	/* A corrupt third entry. */
	valid_copy(&len);
	sys_put_le16(0x1234, &work[FW_IMAGE_TABLE_OFFSET + 64U]);
	expect_fault(len, "invalid_image", "corrupt entry");

	/* The MD5 record erased: entries then the end, no digest. */
	valid_copy(&len);
	memset(&work[md5_record], 0xFF, 32);
	expect_fault(len, "invalid_image", "has no MD5 record");

	/* An entry after the MD5 record. */
	valid_copy(&len);
	memcpy(&work[md5_record + 32U], &work[FW_IMAGE_TABLE_OFFSET], 32);
	expect_fault(len, "invalid_image", "corrupt entry");

	/* A second MD5 record. */
	valid_copy(&len);
	memcpy(&work[md5_record + 32U], &work[md5_record], 32);
	expect_fault(len, "invalid_image", "corrupt entry");

	/* A byte after the end marker inside the table's 0xC00. */
	valid_copy(&len);
	work[FW_IMAGE_TABLE_OFFSET + FW_IMAGE_TABLE_MAX_LEN - 1U] = 0x00;
	expect_fault(len, "invalid_image", "after the partition table's end are not erased");

	/* A table that never ends. */
	valid_copy(&len);
	for (size_t i = 6; i * 32U < FW_IMAGE_TABLE_MAX_LEN; i++) {
		memcpy(&work[FW_IMAGE_TABLE_OFFSET + i * 32U], &work[FW_IMAGE_TABLE_OFFSET], 32);
	}
	expect_fault(len, "invalid_image", "corrupt entry");

	/* Between the table's region and NVS. */
	valid_copy(&len);
	work[FW_IMAGE_TABLE_OFFSET + FW_IMAGE_TABLE_MAX_LEN] = 0x00;
	expect_fault(len, "invalid_image", "Bytes after the partition table are not erased");

	/* The last byte of phy_init. */
	valid_copy(&len);
	work[FW_IMAGE_APP_OFFSET - 1U] = 0x00;
	expect_fault(len, "invalid_image", "NVS, otadata and phy_init");
}

/* Every field of every entry decides the layout; a changed one with a correct MD5. */
ZTEST(fw_image, test_every_layout_field_counts)
{
	static const size_t fields[] = {2, 3, 4, 8, 12, 13, 27, 28};

	for (size_t entry = 0; entry < 5; entry++) {
		for (size_t f = 0; f < ARRAY_SIZE(fields); f++) {
			const size_t at = FW_IMAGE_TABLE_OFFSET + entry * 32U + fields[f];
			const size_t md5_record = FW_IMAGE_TABLE_OFFSET + 5U * 32U;
			const char *message = NULL;
			size_t len;

			valid_copy(&len);
			work[at] ^= 0x01;
			fw_md5(&work[FW_IMAGE_TABLE_OFFSET], 5U * 32U, &work[md5_record + 16U]);
			zassert_equal(run_whole(work, len, &message), FW_IMAGE_INCOMPATIBLE,
				      "entry %zu byte %zu", entry, fields[f]);
		}
	}
}

ZTEST(fw_image, test_one_entry_less_or_more)
{
	const size_t md5_record = FW_IMAGE_TABLE_OFFSET + 5U * 32U;
	const char *message = NULL;
	size_t len;

	/* Four entries: move the MD5 record up and recompute it. */
	valid_copy(&len);
	memcpy(&work[md5_record - 32U], &work[md5_record], 32);
	memset(&work[md5_record], 0xFF, 32);
	fw_md5(&work[FW_IMAGE_TABLE_OFFSET], 4U * 32U, &work[md5_record - 32U + 16U]);
	zassert_equal(run_whole(work, len, &message), FW_IMAGE_INCOMPATIBLE);

	/* Six entries. */
	valid_copy(&len);
	memcpy(&work[md5_record], &work[md5_record - 32U], 32);
	memset(&work[md5_record + 32U], 0xFF, 32);
	work[md5_record + 32U] = 0xEB;
	work[md5_record + 33U] = 0xEB;
	fw_md5(&work[FW_IMAGE_TABLE_OFFSET], 6U * 32U, &work[md5_record + 32U + 16U]);
	zassert_equal(run_whole(work, len, &message), FW_IMAGE_INCOMPATIBLE);
}

ZTEST(fw_image, test_application_faults)
{
	const size_t app = FW_IMAGE_APP_OFFSET;
	size_t len;

	valid_copy(&len);
	work[app] = 0x00;
	expect_fault(len, "invalid_image", "No application image header at 0x10000");

	valid_copy(&len);
	work[app + 1U] = 0;
	expect_fault(len, "invalid_image", "impossible segment count");

	valid_copy(&len);
	work[app + 23U] = 2;
	expect_fault(len, "invalid_image", "no appended SHA-256");

	valid_copy(&len);
	sys_put_le32(0x00FFFFFF, &work[app + 24U + 4U]);
	expect_fault(len, "invalid_image", "application segment runs past the end of the file");

	/* A later segment past the end. */
	valid_copy(&len);
	sys_put_le32(0x10000, &work[app + 24U + 8U + 467U + 4U]);
	expect_fault(len, "invalid_image", "application segment runs past the end of the file");

	valid_copy(&len);
	sys_put_le32(175, &work[app + 24U + 4U]);
	expect_fault(len, "invalid_image", "too short to hold the image description");

	/* Not text in the version, and an empty version. */
	valid_copy(&len);
	work[app + 32U + 16U] = 0x01;
	expect_fault(len, "invalid_image", "does not hold text");

	valid_copy(&len);
	work[app + 32U + 16U] = 0x00;
	expect_fault(len, "invalid_image", "does not hold text");

	/* A version filling its 32 bytes with no terminator. */
	valid_copy(&len);
	memset(&work[app + 32U + 16U], 'v', 32);
	expect_fault(len, "invalid_image", "does not hold text");

	/* A byte of the last segment: checksum. */
	valid_copy(&len);
	work[len - 60U] ^= 0x01;
	expect_fault(len, "invalid_image", "application's checksum does not match");
}

ZTEST(fw_image, test_empty_idf_version_is_accepted)
{
	const char *message = NULL;
	size_t len;
	const size_t app = FW_IMAGE_APP_OFFSET;

	valid_copy(&len);
	/* Blank the IDF text, then fix the checksum and digest the change broke. */
	uint8_t old_xor = 0;

	for (size_t i = 0; i < FW_IMAGE_TEXT_MAX; i++) {
		old_xor ^= work[app + 32U + 112U + i];
		work[app + 32U + 112U + i] = 0;
	}
	const size_t checksum_at = len - 33U;

	work[checksum_at] ^= old_xor;
	sha256_of(&work[app], checksum_at + 1U - app, &work[checksum_at + 1U]);
	zassert_equal(run_whole(work, len, &message), FW_IMAGE_OK, "%s", message ? message : "");
}

ZTEST(fw_image, test_structural_fault_outranks_a_layout_mismatch)
{
	const struct fixture *f = fixture("other_layout");
	size_t len = f->len;

	memcpy(work, f->data, len);
	work[0xA000] = 0x00;
	expect_fault(len, "invalid_image", "NVS, otadata and phy_init");

	memcpy(work, f->data, len);
	sys_put_le16(5, &work[FW_IMAGE_APP_OFFSET + 12U]);
	expect_fault(len, "unsupported_target", "application is built for another chip");
}

ZTEST(fw_image, test_failed_is_reported_early)
{
	const struct fixture *f = fixture("bootloader_wrong_chip");

	fw_image_check_begin(&check, (uint32_t)f->len);
	zassert_false(fw_image_check_failed(&check));
	fw_image_check_feed(&check, f->data, 24);
	zassert_true(fw_image_check_failed(&check));
	fw_image_check_abort(&check);
}

ZTEST(fw_image, test_whole_file_digest_survives_a_fault)
{
	const struct fixture *f = fixture("junk_in_nvs");
	struct fw_image_info info;
	const char *message = NULL;
	uint8_t digest[32];

	zassert_equal(run(f->data, f->len, (uint32_t)f->len, 1000, &info, &message),
		      FW_IMAGE_INVALID);
	sha256_of(f->data, f->len, digest);
	zassert_mem_equal(info.sha256, digest, sizeof(digest));
}

ZTEST(fw_image, test_description_text_is_printable_ascii)
{
	size_t len;

	valid_copy(&len);
	work[FW_IMAGE_APP_OFFSET + 32U + 16U + 1U] = 0x7F;
	expect_fault(len, "invalid_image", "does not hold text");

	valid_copy(&len);
	work[FW_IMAGE_APP_OFFSET + 32U + 48U] = 0x1F;
	expect_fault(len, "invalid_image", "does not hold text");
}

ZTEST(fw_image, test_every_md5_byte_counts)
{
	const size_t md5_record = FW_IMAGE_TABLE_OFFSET + 5U * 32U;
	size_t len;

	valid_copy(&len);
	work[md5_record + 31U] ^= 0x01;
	expect_fault(len, "invalid_image", "MD5 record does not match");
}

ZTEST(fw_image, test_table_without_an_end)
{
	size_t len;

	/* 96 entries fill the table's 0xC00: no MD5, no end marker. */
	valid_copy(&len);
	for (size_t i = 1; i * 32U < FW_IMAGE_TABLE_MAX_LEN; i++) {
		memcpy(&work[FW_IMAGE_TABLE_OFFSET + i * 32U], &work[FW_IMAGE_TABLE_OFFSET], 32);
	}
	expect_fault(len, "invalid_image", "has no end");
}

ZTEST(fw_image, test_largest_declared_size_is_not_refused_for_size)
{
	const struct fixture *f = fixture("valid");
	struct fw_image_info info;
	const char *message = NULL;

	zassert_equal(run(f->data, f->len, FW_IMAGE_MAX_BYTES, f->len, &info, &message),
		      FW_IMAGE_INVALID);
	assert_message(message, "shorter than its declared size");
}

ZTEST(fw_image, test_application_cut_inside_its_digest)
{
	const struct fixture *f = fixture("valid");
	struct fw_image_info info;
	const char *message = NULL;

	zassert_equal(run(f->data, f->len - 10U, (uint32_t)f->len - 10U, 4096, &info, &message),
		      FW_IMAGE_INVALID);
	assert_message(message, "The application is cut short");
}

ZTEST(fw_image, test_no_layout_after_a_structural_fault)
{
	const struct fixture *f = fixture("junk_in_nvs");
	struct fw_image_info info;
	const char *message = NULL;

	zassert_equal(run(f->data, f->len, (uint32_t)f->len, f->len, &info, &message),
		      FW_IMAGE_INVALID);
	zassert_is_null(info.layout_id);
	zassert_is_null(info.host_protocol);
}

ZTEST(fw_image, test_first_application_segment_past_the_file)
{
	size_t len;

	/* Within the size an image may have, beyond this file: only the bootloader's
	 * first segment is allowed to overrun until its description is read. */
	valid_copy(&len);
	sys_put_le32(0x10000, &work[FW_IMAGE_APP_OFFSET + 24U + 4U]);
	expect_fault(len, "invalid_image", "application segment runs past the end of the file");
}

ZTEST(fw_image, test_md5_record_before_any_entry)
{
	static const uint8_t empty_md5[16] = {0xd4, 0x1d, 0x8c, 0xd9, 0x8f, 0x00, 0xb2, 0x04,
					      0xe9, 0x80, 0x09, 0x98, 0xec, 0xf8, 0x42, 0x7e};
	size_t len;

	valid_copy(&len);
	memset(&work[FW_IMAGE_TABLE_OFFSET], 0xFF, 32);
	work[FW_IMAGE_TABLE_OFFSET] = 0xEB;
	work[FW_IMAGE_TABLE_OFFSET + 1U] = 0xEB;
	memcpy(&work[FW_IMAGE_TABLE_OFFSET + 16U], empty_md5, sizeof(empty_md5));
	expect_fault(len, "invalid_image", "No partition table at 0x8000");
}

ZTEST(fw_image, test_one_piece_running_past_the_declared_size)
{
	struct fw_image_info info;
	const char *message = NULL;
	size_t len;

	valid_copy(&len);
	memset(&work[len], 0x00, 100);
	fw_image_check_begin(&check, (uint32_t)len);
	fw_image_check_feed(&check, work, len + 100U);
	zassert_equal(fw_image_check_end(&check, &info, &message), FW_IMAGE_OK, "%s",
		      message ? message : "");
	sha256_of(work, len, work + len);
	zassert_mem_equal(info.sha256, work + len, 32);
}

ZTEST(fw_image, test_result_codes)
{
	zassert_is_null(fw_image_result_code(FW_IMAGE_OK));
	zassert_str_equal(fw_image_result_code(FW_IMAGE_INVALID), "invalid_image");
	zassert_str_equal(fw_image_result_code(FW_IMAGE_UNSUPPORTED_TARGET), "unsupported_target");
	zassert_str_equal(fw_image_result_code(FW_IMAGE_INCOMPATIBLE), "incompatible_firmware");
}

ZTEST_SUITE(fw_image, NULL, NULL, NULL, NULL, NULL);
```

## src/md5.c
```c
/*
 * SPDX-License-Identifier: Apache-2.0
 *
 * fw_md5: the RFC 1321 test suite, the block boundaries (values from Python's
 * hashlib) and streaming in arbitrary splits.
 */

#include <string.h>

#include <zephyr/ztest.h>

#include <firmware_store/fw_md5.h>

static void hex(const uint8_t *digest, char *out)
{
	for (int i = 0; i < 16; i++) {
		static const char digits[] = "0123456789abcdef";

		out[i * 2] = digits[digest[i] >> 4];
		out[i * 2 + 1] = digits[digest[i] & 0xF];
	}
	out[32] = '\0';
}

static void assert_md5(const uint8_t *data, size_t len, const char *expected)
{
	uint8_t digest[16];
	char text[33];

	fw_md5(data, len, digest);
	hex(digest, text);
	zassert_str_equal(text, expected, "length %zu", len);
}

ZTEST(fw_md5, test_rfc1321_suite)
{
	static const struct {
		const char *in;
		const char *md5;
	} v[] = {
		{"", "d41d8cd98f00b204e9800998ecf8427e"},
		{"a", "0cc175b9c0f1b6a831c399e269772661"},
		{"abc", "900150983cd24fb0d6963f7d28e17f72"},
		{"message digest", "f96b697d7cb7938d525a2f31aaf161d0"},
		{"abcdefghijklmnopqrstuvwxyz", "c3fcd3d76192e4007dfb496cca67e13b"},
		{"ABCDEFGHIJKLMNOPQRSTUVWXYZabcdefghijklmnopqrstuvwxyz0123456789",
		 "d174ab98d277d9f5a5611c2c9f419d9f"},
		{"12345678901234567890123456789012345678901234567890123456789012345678901234567890",
		 "57edf4a22be3c955ac49da2e2107b67a"},
	};

	for (size_t i = 0; i < ARRAY_SIZE(v); i++) {
		assert_md5((const uint8_t *)v[i].in, strlen(v[i].in), v[i].md5);
	}
}

ZTEST(fw_md5, test_block_boundaries)
{
	static uint8_t a[65];
	static uint8_t ramp[1024];

	memset(a, 'a', sizeof(a));
	for (size_t i = 0; i < sizeof(ramp); i++) {
		ramp[i] = (uint8_t)i;
	}
	assert_md5(a, 55, "ef1772b6dff9a122358552954ad0df65");
	assert_md5(a, 56, "3b0c8ac703f828b04c6c197006d17218");
	assert_md5(a, 63, "b06521f39153d618550606be297466d5");
	assert_md5(a, 64, "014842d480b571495a4a0363793f7367");
	assert_md5(a, 65, "c743a45e0d2e6a95cb859adae0248435");
	assert_md5(ramp, sizeof(ramp), "b2ea9f7fcea831a4a63b213f41a8855b");
}

ZTEST(fw_md5, test_streaming_in_any_split)
{
	static uint8_t ramp[1024];
	uint8_t whole[16];

	for (size_t i = 0; i < sizeof(ramp); i++) {
		ramp[i] = (uint8_t)(i * 7);
	}
	fw_md5(ramp, sizeof(ramp), whole);

	for (size_t split = 1; split < 200; split += 13) {
		struct fw_md5 ctx;
		uint8_t digest[16];

		fw_md5_init(&ctx);
		for (size_t off = 0; off < sizeof(ramp); off += split) {
			fw_md5_update(&ctx, &ramp[off], MIN(split, sizeof(ramp) - off));
		}
		fw_md5_final(&ctx, digest);
		zassert_mem_equal(digest, whole, sizeof(whole), "split %zu", split);
	}
}

ZTEST_SUITE(fw_md5, NULL, NULL, NULL, NULL, NULL);
```
