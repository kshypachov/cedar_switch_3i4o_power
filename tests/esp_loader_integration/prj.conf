## CMakeLists.txt
```
# SPDX-License-Identifier: Apache-2.0

cmake_minimum_required(VERSION 3.20.0)
find_package(Zephyr REQUIRED HINTS $ENV{ZEPHYR_BASE})
project(esp_loader_integration)

target_sources(app PRIVATE src/main.c)
```

## prj.conf
```kconfig
# Standalone P0 check: does esp-serial-flasher build for this board and talk to
# the ESP32-C6 over USART3? Deliberately minimal - no networking, no Matter, no
# esp-hosted, so that a failure points at the loader integration and nothing else.

CONFIG_ESP_SERIAL_FLASHER=y
CONFIG_SERIAL_FLASHER_LOG_LEVEL_INFO=y

# Match the board's download-mode sequence from src/plugin_wifi/wifi.c, which
# holds the boot strap 200 ms after releasing reset. Verified on hardware
# 2026-09-12; the library's 50 ms default was not exercised.
CONFIG_SERIAL_FLASHER_RESET_HOLD_TIME_MS=100
CONFIG_SERIAL_FLASHER_BOOT_HOLD_TIME_MS=200

CONFIG_GPIO=y
CONFIG_SERIAL=y
CONFIG_CONSOLE=y
CONFIG_CONSOLE_GETCHAR=y

CONFIG_LOG=y
CONFIG_LOG_DEFAULT_LEVEL=4
CONFIG_LOG_MODE_IMMEDIATE=y

CONFIG_MAIN_STACK_SIZE=4096

# Boot chain, mirrored from the application's prj.conf. MCUboot already lives in
# internal flash on the board; this image goes into the same external-QSPI slot0
# it boots, so it must be linked and headered the same way.
CONFIG_BOOTLOADER_MCUBOOT=y
CONFIG_FLASH_STM32_NOR_MEMMAP=y
CONFIG_XIP=y
CONFIG_ARM_MPU=y
CONFIG_MCUBOOT_GENERATE_UNSIGNED_IMAGE=y
CONFIG_MCUBOOT_BOOT_MAX_ALIGN=16
# Flash driver LOG calls run from QSPI-resident code and hard-fault; the
# application disables them for the same reason.
CONFIG_FLASH_LOG_LEVEL_OFF=y

# Keep the console free of shell prompts so the loader trace is readable.
CONFIG_SHELL=n
```

## boards/cedar_switch_3in4out_power_rev3_stm32u585xx_ext_flash_app.overlay
```dts
/*
 * esp-serial-flasher target interface for the on-board ESP32-C6.
 *
 * USART3 (PC10/PC11) is the coprocessor's console/ROM-loader line. EN and the
 * IO9 boot strap are wired directly, so "active" means asserted-low here, the
 * same convention the board's gpio-outputs node already uses.
 *
 * Both pins are also listed under /gpio-outputs; that node's driver is not
 * enabled in this standalone build, so the loader owns them exclusively. In the
 * application the hand-off is explicit and belongs to coprocessor-manager.
 */

/ {
	esp_loader0: esp_loader {
		compatible = "espressif,esp-loader";
		uart = <&usart3>;
		reset-gpios = <&gpioa 8 GPIO_ACTIVE_LOW>;
		boot-gpios = <&gpioc 0 GPIO_ACTIVE_LOW>;
		default-baudrate = <115200>;
		/* Stay at the rate proven on this board; raise only after the
		 * baseline flow is reproducible. */
		higher-baudrate = <0>;
		num-trials = <10>;
		sync-timeout-ms = <100>;
		status = "okay";
	};

	chosen {
		zephyr,esp-loader = &esp_loader0;
	};
};

/*
 * The board pairs USART3 with the USB CDC-ACM bridge. Two owners of one UART is
 * exactly what must not happen while flashing, and in this minimal build the
 * CDC-ACM endpoint does not exist at all, so the bridge would not even link.
 * Disable it here; in the application the bridge is suspended for the duration
 * of an update instead.
 */
&{/uart-bridge0} {
	status = "disabled";
};
```

## src/main.c
```c
/*
 * P0 integration check for esp-serial-flasher on the Cedar switch board.
 *
 * Non-destructive on purpose: it enters the ROM download mode, identifies the
 * coprocessor and returns it to normal boot. Nothing is erased or written, so
 * this can be run on a board carrying production coprocessor firmware.
 *
 * What a pass proves: the west module builds, the devicetree node is wired to
 * the right UART and straps, EN/BOOT timing gets the C6 into the ROM loader,
 * and the serial protocol completes a round trip.
 */

#include <zephyr/kernel.h>
#include <zephyr/device.h>

#include <esp_loader.h>
#include <esp_loader_io.h>
#include <zephyr_port.h>

#include <zephyr/logging/log.h>
LOG_MODULE_REGISTER(esp_loader_check, LOG_LEVEL_INF);

static const struct device *const loader_dev =
	DEVICE_DT_GET(DT_CHOSEN(zephyr_esp_loader));

static const char *target_name(target_chip_t chip)
{
	switch (chip) {
	case ESP8266_CHIP:  return "ESP8266";
	case ESP32_CHIP:    return "ESP32";
	case ESP32S2_CHIP:  return "ESP32-S2";
	case ESP32C3_CHIP:  return "ESP32-C3";
	case ESP32S3_CHIP:  return "ESP32-S3";
	case ESP32C2_CHIP:  return "ESP32-C2";
	case ESP32C5_CHIP:  return "ESP32-C5";
	case ESP32H2_CHIP:  return "ESP32-H2";
	case ESP32C6_CHIP:  return "ESP32-C6";
	case ESP32P4_CHIP:  return "ESP32-P4";
	case ESP32C61_CHIP: return "ESP32-C61";
	default:            return "unknown";
	}
}

int main(void)
{
	esp_loader_connect_args_t args;
	esp_loader_error_t err;
	target_chip_t chip;

	LOG_INF("esp-serial-flasher integration check");

	if (!device_is_ready(loader_dev)) {
		LOG_ERR("esp-loader device not ready");
		return -ENODEV;
	}

	esp_loader_t *loader = esp_loader_from_device(loader_dev);
	const esp_loader_connect_args_t *dt_args =
		esp_loader_connect_args_from_device(loader_dev);

	/* esp_loader_connect() takes a mutable pointer; keep the DT values intact. */
	args = *dt_args;

	LOG_INF("connecting: %d trials, %u ms sync timeout",
		args.trials, args.sync_timeout);

	err = esp_loader_connect(loader, &args);
	if (err != ESP_LOADER_SUCCESS) {
		LOG_ERR("connect failed: %d", err);
		LOG_ERR("check USART3 wiring, EN/BOOT straps, and that nothing "
			"else holds the UART");
		return -EIO;
	}

	chip = esp_loader_get_target(loader);
	LOG_INF("connected, target reports: %s", target_name(chip));

	/* Always hand the coprocessor back, including on a wrong-chip result. */
	esp_loader_reset_target(loader);
	LOG_INF("target released to normal boot");

	if (chip != ESP32C6_CHIP) {
		LOG_ERR("expected ESP32-C6, got %s", target_name(chip));
		return -ENOTSUP;
	}

	LOG_INF("PASS");
	return 0;
}
```
